## firmware/drivers/Kconfig
```kconfig
# Copyright (c) 2026 Het Bhavsar
# SPDX-License-Identifier: Apache-2.0

menuconfig MAXM86161
	bool "MAXM86161 optical module"
	default y
	depends on DT_HAS_ADI_MAXM86161_ENABLED
	select I2C
	select GPIO
	help
	  Driver for the MAXM86161A optical module (pod U3). The MAXM86161
	  has the same register map and part ID, so it runs either part.

if MAXM86161

config MAXM86161_INIT_PRIORITY
	int "Init priority"
	default 80

module = MAXM86161
module-str = maxm86161
source "subsys/logging/Kconfig.template.log_config"

endif # MAXM86161

config LSM6DSV16BX
	bool "LSM6DSV16BX accelerometer"
	default y
	depends on DT_HAS_ST_LSM6DSV16BX_ENABLED
	depends on SENSOR
	select I2C
	select GPIO
	help
	  Accelerometer of the pod's IMU (U11): rate, data-ready on INT1 and
	  x, y, z at +-2 g. The gyroscope, TDM and Qvar stay off.
```

## firmware/drivers/dts/bindings/sensor/st,lsm6dsv16bx.yaml
```yaml
# Copyright (c) 2026 Het Bhavsar
# SPDX-License-Identifier: Apache-2.0

description: |
  LSM6DSV16BX accelerometer and gyroscope with TDM audio output (ST DS13771), WHO_AM_I 0x71.
  The Atrium driver (firmware/drivers/lsm6dsv16bx) runs the accelerometer only, at +-2 g, with
  data-ready on INT1.

compatible: "st,lsm6dsv16bx"

include: i2c-device.yaml

properties:
  int1-gpios:
    type: phandle-array
    required: true
    description: INT1, push-pull, active high (the reset setting of IF_CFG).
  low-power-max-mhz:
    type: int
    default: 15000
    description: |
      Output rates up to this one (mHz) run in low-power mode with 2 averages; faster rates run
      in high-performance mode. The chip's low-power modes go up to 240 Hz.
```
