## CMakeLists.txt
```
# SPDX-License-Identifier: Apache-2.0
cmake_minimum_required(VERSION 3.20.0)
find_package(Zephyr REQUIRED HINTS $ENV{ZEPHYR_BASE})
project(atrium_power_tests)

set(FW_SRC ${CMAKE_CURRENT_SOURCE_DIR}/../../src/power)
target_include_directories(app PRIVATE ${FW_SRC})
target_sources(app PRIVATE
  ${FW_SRC}/charge_policy.c
  ${FW_SRC}/cutoff.c
  ${FW_SRC}/dock.c
  ${FW_SRC}/modes.c
  ${FW_SRC}/ntc.c
  ${FW_SRC}/power_sm.c
  ${FW_SRC}/wear.c
  ${FW_SRC}/headroom.c
  ${FW_SRC}/soc_est.c
  ${FW_SRC}/vinpat.c
  src/test_charge_policy.c
  src/test_cutoff.c
  src/test_dock.c
  src/test_modes.c
  src/test_ntc.c
  src/test_power_sm.c
  src/test_wear.c
  src/test_headroom.c
  src/test_soc_est.c
  src/test_vinpat.c
)
```

## prj.conf
```kconfig
CONFIG_ZTEST=y
CONFIG_REQUIRES_FLOAT_PRINTF=y
```

## src/test_charge_policy.c
```c
/*
 * Copyright (c) 2026 Het Bhavsar
 * SPDX-License-Identifier: Apache-2.0
 */
#include <zephyr/ztest.h>

#include "charge_policy.h"

static struct charge_policy p;
static uint32_t now;

static void before(void *f)
{
	ARG_UNUSED(f);
	struct charge_policy_cfg cfg = CHARGE_POLICY_CFG_DEFAULT;

	charge_policy_init(&p, &cfg);
	now = 1000;
}

ZTEST_SUITE(charge_policy, NULL, NULL, before, NULL, NULL);

static struct charge_temps both(int32_t tmp, int32_t ntc)
{
	struct charge_temps t = {
		.primary = {.valid = true, .cc = tmp, .at_ms = now},
		.backup = {.valid = true, .cc = ntc, .at_ms = now},
	};
	return t;
}

static bool step(int32_t tmp, int32_t ntc)
{
	struct charge_temps t = both(tmp, ntc);

	now += 1000;
	t.primary.at_ms = t.backup.at_ms = now;
	return charge_policy_update(&p, now, true, &t);
}

ZTEST(charge_policy, test_normal_band_charges)
{
	zassert_false(step(2500, 2500));
	zassert_equal(p.band, CHG_BAND_NORMAL);
}

ZTEST(charge_policy, test_cold_band_charges_at_cold_current)
{
	/* the cold current (0.2C at most) is set by the caller; charging stays enabled */
	zassert_false(step(500, 500));
	zassert_equal(p.band, CHG_BAND_COLD);
}

ZTEST(charge_policy, test_hot_stops_with_hysteresis)
{
	zassert_false(step(4500, 4500));     /* 45.00 C is still inside */
	zassert_true(step(4501, 4501));
	zassert_equal(p.band, CHG_BAND_HOT);
	zassert_true(step(4450, 4450));      /* inside the 1 C hysteresis */
	zassert_true(step(4401, 4401));
	zassert_false(step(4400, 4400));
}

ZTEST(charge_policy, test_freeze_stops_with_hysteresis)
{
	zassert_true(step(-1, -1));
	zassert_equal(p.band, CHG_BAND_FREEZE);
	zassert_true(step(50, 50));
	zassert_false(step(100, 100));       /* 1.0 C: cold band */
	zassert_equal(p.band, CHG_BAND_COLD);
}

ZTEST(charge_policy, test_cold_band_edges)
{
	zassert_false(step(1000, 1000));
	zassert_equal(p.band, CHG_BAND_NORMAL);
	step(999, 999);
	zassert_equal(p.band, CHG_BAND_COLD);
	step(1050, 1050);
	zassert_equal(p.band, CHG_BAND_COLD);
	step(1100, 1100);
	zassert_equal(p.band, CHG_BAND_NORMAL);
}

ZTEST(charge_policy, test_primary_decides)
{
	/* step(primary TH4, backup): the primary is over the limit, the backup is not */
	zassert_true(step(4600, 4400));
	zassert_equal(p.band, CHG_BAND_HOT);
	/* backup over, primary inside: the primary decides */
	charge_policy_init(&p, &p.cfg);
	zassert_false(step(4400, 4600));
	zassert_equal(p.band, CHG_BAND_NORMAL);
	step(900, 1200);
	zassert_equal(p.band, CHG_BAND_COLD);
}

ZTEST(charge_policy, test_backup_takes_over)
{
	struct charge_temps t = both(2500, 4800);

	t.primary.valid = false; /* TH4 open: the backup decides */
	zassert_true(charge_policy_update(&p, now, true, &t));
	zassert_equal(p.band, CHG_BAND_HOT);
}

/* The EVT board: TH4 alone, the backup slot never valid. TH4 decides every band, and
 * losing it disables charging. */
ZTEST(charge_policy, test_primary_alone)
{
	static const struct {
		int32_t cc;
		bool disable;
	} pts[] = {{2500, false}, {500, false}, {4600, true}, {-100, true}};

	for (size_t i = 0; i < ARRAY_SIZE(pts); i++) {
		struct charge_policy_cfg cfg = CHARGE_POLICY_CFG_DEFAULT;
		struct charge_temps t = {.primary = {.valid = true, .cc = pts[i].cc, .at_ms = now}};

		charge_policy_init(&p, &cfg);
		zassert_equal(charge_policy_update(&p, now, true, &t), pts[i].disable, "%d cC", pts[i].cc);
	}
	struct charge_temps t = {.primary = {.valid = true, .cc = 2500, .at_ms = now}};

	zassert_false(charge_policy_update(&p, now, true, &t));
	now += 11000; /* TH4 goes stale */
	zassert_true(charge_policy_update(&p, now, true, &t), "no fresh reading: disable");
	t.primary.valid = false;
	t.primary.at_ms = now;
	zassert_true(charge_policy_update(&p, now, true, &t), "TH4 open: disable");
}

ZTEST(charge_policy, test_one_stale_sensor_uses_other)
{
	struct charge_temps t = both(2500, 4800);

	t.backup.at_ms = now - 20000; /* stale and hot backup: ignored */
	zassert_false(charge_policy_update(&p, now, true, &t));
	zassert_equal(p.band, CHG_BAND_NORMAL);
}

ZTEST(charge_policy, test_no_temperature_disables)
{
	struct charge_temps t = {0};

	zassert_true(charge_policy_update(&p, now, true, &t));
	zassert_equal(p.band, CHG_BAND_FAULT);
}

ZTEST(charge_policy, test_disagreement_is_a_fault)
{
	zassert_true(step(1500, 2600));
	zassert_equal(p.band, CHG_BAND_FAULT);
	zassert_false(step(1500, 2500));
}

ZTEST(charge_policy, test_undocked_disables_nothing)
{
	struct charge_temps t = both(5000, 5000);

	zassert_false(charge_policy_update(&p, now, false, &t));
	zassert_equal(p.band, CHG_BAND_HOT);
}

/* "no charge outside 0-45 C, the cold current from 0 to 10 C", over a sweep */
ZTEST(charge_policy, test_sweep_invariant)
{
	for (int32_t cc = -1000; cc <= 6000; cc += 25) {
		struct charge_policy_cfg cfg = CHARGE_POLICY_CFG_DEFAULT;

		charge_policy_init(&p, &cfg);
		bool off = step(cc, cc);

		if (cc < 0 || cc > 4500) {
			zassert_true(off, "charging at %d cC", cc);
		} else {
			zassert_false(off, "blocked at %d cC", cc);
			zassert_equal(p.band, cc < 1000 ? CHG_BAND_COLD : CHG_BAND_NORMAL, "%d cC", cc);
		}
	}
}

ZTEST(charge_policy, test_band_names)
{
	zassert_str_equal(charge_band_name(CHG_BAND_COLD), "cold");
	zassert_str_equal(charge_band_name((enum charge_band)99), "?");
}
```

## src/test_cutoff.c
```c
/*
 * Copyright (c) 2026 Het Bhavsar
 * SPDX-License-Identifier: Apache-2.0
 */
#include <zephyr/ztest.h>

#include "cutoff.h"

static struct cutoff c;

static void before(void *f)
{
	ARG_UNUSED(f);
	struct cutoff_cfg cfg = CUTOFF_CFG_DEFAULT;

	cutoff_init(&c, &cfg);
}

ZTEST_SUITE(cutoff, NULL, NULL, before, NULL, NULL);

/* Cut-off above the protection IC's VDL (AP6683 2.8 V; the LPB1010 fallback is 2.90 V max).
 * Under a 30 mA peak (a 15 mA LED pulse plus radio TX) a 2.0 ohm cell [ASSUMED] sags 60 mV,
 * and 3.24 V still leaves the red LED (Vf 2.4 V max at 20 mA, MAXM86161A data sheet) about
 * 0.8 V of driver compliance. The green limit (green-min-mv plus sag, headroom.c) now sits
 * below the cut-off. */
ZTEST(cutoff, test_limits_hold_rev_b2_headroom)
{
	zassert_equal(c.cfg.cutoff_mv, 3300);
	zassert_true(c.cfg.cutoff_mv > 2900);
	zassert_true(c.cfg.cutoff_mv - 30 * 2000 / 1000 - 2400 >= 800);
}

ZTEST(cutoff, test_needs_three_readings_in_a_row)
{
	zassert_equal(cutoff_update(&c, false, 3290), BATT_LOW);
	zassert_equal(cutoff_update(&c, false, 3290), BATT_LOW);
	zassert_equal(cutoff_update(&c, false, 3290), BATT_CUTOFF);
}

ZTEST(cutoff, test_burst_droop_does_not_trip)
{
	/* a reading inside an LED burst, then the cell recovers */
	for (int i = 0; i < 20; i++) {
		cutoff_update(&c, false, (i % 2) ? 3280 : 3310);
	}
	zassert_not_equal(c.state, BATT_CUTOFF);
}

ZTEST(cutoff, test_exactly_at_limit_is_not_below)
{
	for (int i = 0; i < 10; i++) {
		cutoff_update(&c, false, 3300);
	}
	zassert_equal(c.state, BATT_LOW);
}

ZTEST(cutoff, test_no_cutoff_on_dock)
{
	for (int i = 0; i < 10; i++) {
		zassert_not_equal(cutoff_update(&c, true, 3000), BATT_CUTOFF);
	}
}

ZTEST(cutoff, test_cutoff_latches_until_charger)
{
	for (int i = 0; i < 3; i++) {
		cutoff_update(&c, false, 3200);
	}
	zassert_equal(c.state, BATT_CUTOFF);
	/* load drops as the pod shuts down and VCELL rebounds: still shipping */
	zassert_equal(cutoff_update(&c, false, 3600), BATT_CUTOFF);
	/* the dock releases it */
	zassert_equal(cutoff_update(&c, true, 3400), BATT_LOW);
	zassert_equal(cutoff_update(&c, true, 3700), BATT_OK);
}

ZTEST(cutoff, test_charger_present_without_reading)
{
	for (int i = 0; i < 3; i++) {
		cutoff_update(&c, false, 3200);
	}
	zassert_equal(cutoff_charger_present(&c), BATT_LOW);
}

ZTEST(cutoff, test_invalid_readings_ignored)
{
	cutoff_update(&c, false, 3200);
	cutoff_update(&c, false, 0);     /* no VSYS reading yet */
	cutoff_update(&c, false, 65535); /* bus error */
	cutoff_update(&c, false, 3200);
	zassert_equal(c.state, BATT_LOW);
	zassert_equal(cutoff_update(&c, false, 3200), BATT_CUTOFF);
}

ZTEST(cutoff, test_low_battery_hysteresis)
{
	zassert_equal(cutoff_update(&c, false, 3800), BATT_OK);
	zassert_equal(cutoff_update(&c, false, 3440), BATT_LOW);
	zassert_equal(cutoff_update(&c, false, 3500), BATT_LOW);
	zassert_equal(cutoff_update(&c, false, 3560), BATT_OK);
}

/* Discharge like logic_sim.py: OCV curve minus I*R, VCELL every 45 s (hibernate cadence).
 * Ship mode must start before the loaded voltage gets near the LPB1010 trip. */
ZTEST(cutoff, test_discharge_reaches_ship_above_vdl)
{
	static const float soc_t[] = {0, .03f, .06f, .1f, .2f};
	static const float ocv_t[] = {3.00f, 3.35f, 3.50f, 3.60f, 3.69f};
	float soc = 0.2f, cap_mah = 32.0f, i_ma = 0.61f, r = 0.8f; /* aged cell, smart worst case */
	float v = 0;
	int steps = 0;

	while (c.state != BATT_CUTOFF && soc > 0 && steps < 100000) {
		int k = 0;

		while (k < 3 && soc > soc_t[k + 1]) {
			k++;
		}
		float ocv = ocv_t[k] + (ocv_t[k + 1] - ocv_t[k]) * (soc - soc_t[k]) / (soc_t[k + 1] - soc_t[k]);

		v = ocv - i_ma * 1e-3f * r;
		cutoff_update(&c, false, (uint16_t)(v * 1000.0f));
		soc -= i_ma * (45.0f / 3600.0f) / cap_mah;
		steps++;
	}
	zassert_equal(c.state, BATT_CUTOFF);
	zassert_true(v > 3.25f, "ship started at %.3f V", (double)v);
	zassert_true(v < 3.30f);
}
```

## src/test_dock.c
```c
/*
 * Copyright (c) 2026 Het Bhavsar
 * SPDX-License-Identifier: Apache-2.0
 */
#include <zephyr/ztest.h>

#include "dock.h"

static struct dock d;

static void before(void *f)
{
	ARG_UNUSED(f);
	struct dock_cfg cfg = DOCK_CFG_DEFAULT;

	dock_init(&d, &cfg);
}

ZTEST_SUITE(dock, NULL, NULL, before, NULL, NULL);

ZTEST(dock, test_pg_low_docks_after_debounce)
{
	zassert_false(dock_update(&d, true));
	zassert_true(dock_update(&d, true));
	zassert_true(dock_update(&d, true));
}

ZTEST(dock, test_single_bounce_ignored)
{
	dock_update(&d, true);
	dock_update(&d, false); /* the contact bounced as the pod seated */
	zassert_false(dock_update(&d, true));
	zassert_true(dock_update(&d, true));
	/* and on the way off */
	dock_update(&d, false);
	zassert_true(dock_update(&d, true));
	zassert_true(dock_update(&d, false));
	zassert_false(dock_update(&d, false));
}

static const struct chg_report ok = {.valid = true};

ZTEST(dock, test_chg_state)
{
	struct chg_report done = {.valid = true, .done = true};
	struct chg_report ts = {.valid = true, .ts_stop = true};
	struct chg_report fault = {.valid = true, .fault = true};
	struct chg_report none = {0};

	zassert_equal(chg_state_classify(false, CHG_BAND_NORMAL, &ok), CHG_UNDOCKED);
	zassert_equal(chg_state_classify(true, CHG_BAND_NORMAL, &ok), CHG_CHARGING);
	zassert_equal(chg_state_classify(true, CHG_BAND_NORMAL, &done), CHG_FULL);
	zassert_equal(chg_state_classify(true, CHG_BAND_COLD, &ok), CHG_COLD_LIMITED);
	zassert_equal(chg_state_classify(true, CHG_BAND_COLD, &done), CHG_FULL);
	/* the charger's own TS stopped it: the cell is out of range even if TH4 is not */
	zassert_equal(chg_state_classify(true, CHG_BAND_NORMAL, &ts), CHG_TEMP_BLOCKED);
	zassert_equal(chg_state_classify(true, CHG_BAND_HOT, &ok), CHG_TEMP_BLOCKED);
	zassert_equal(chg_state_classify(true, CHG_BAND_FAULT, &done), CHG_TEMP_BLOCKED);
	zassert_equal(chg_state_classify(true, CHG_BAND_NORMAL, &fault), CHG_FAULT);
	zassert_equal(chg_state_classify(true, CHG_BAND_NORMAL, &none), CHG_FAULT,
		      "no answer on I2C");
	zassert_str_equal(chg_state_name(CHG_FULL), "full");
	zassert_str_equal(chg_state_name(CHG_FAULT), "fault");
}
```

## src/test_headroom.c
```c
/*
 * Copyright (c) 2026 Het Bhavsar
 * SPDX-License-Identifier: Apache-2.0
 */
#include <zephyr/ztest.h>

#include "headroom.h"
#include "modes.h"

ZTEST_SUITE(headroom, NULL, NULL, NULL, NULL, NULL);

ZTEST(headroom, test_limit_adds_pulse_sag)
{
	/* 3.5 V green need, 15 mA green, 2.0 ohm cell at end of life and cold [ASSUMED] */
	zassert_equal(headroom_limit_mv(3500, 15, 2000), 3530);
	zassert_equal(headroom_limit_mv(3500, 0, 2000), 3500);
}

ZTEST(headroom, test_green_drops_and_returns_with_hysteresis)
{
	struct headroom h;

	headroom_init(&h, 3530);
	zassert_true(headroom_update(&h, 3800));
	zassert_true(headroom_update(&h, 3530));
	zassert_false(headroom_update(&h, 3529));
	zassert_false(headroom_update(&h, 3570), "inside the hysteresis");
	zassert_true(headroom_update(&h, 3580));
}

ZTEST(headroom, test_green_swaps_to_ir)
{
	struct mode_cfg low;

	for (int i = 0; i < MODE_COUNT; i++) {
		const struct mode_cfg *m = mode_get(i);
		uint8_t n = mode_green_to_ir(m, &low);
		bool had_green = false;

		for (uint8_t s = 0; s < m->n_slots; s++) {
			had_green |= m->slot[s].led == LED_GREEN;
		}
		for (uint8_t s = 0; s < n; s++) {
			zassert_not_equal(low.slot[s].led, LED_GREEN, "%s", m->name);
		}
		/* every mode with green keeps a pulse source, and never repeats an LED */
		if (had_green) {
			zassert_true(n > 0, "%s has no pulse source", m->name);
		}
		uint8_t used = 0;

		for (uint8_t s = 0; s < n; s++) {
			zassert_false(used & BIT(low.slot[s].led), "%s repeats an LED", m->name);
			used |= BIT(low.slot[s].led);
		}
	}
	/* smart's single green slot becomes IR at the same current */
	mode_green_to_ir(mode_get(MODE_SMART), &low);
	zassert_equal(low.n_slots, 1);
	zassert_equal(low.slot[0].led, LED_IR);
	zassert_equal(low.slot[0].ma, 15);
	/* full already has IR: green is dropped */
	zassert_equal(mode_green_to_ir(mode_get(MODE_FULL), &low), 2);
}
```

## src/test_modes.c
```c
/*
 * Copyright (c) 2026 Het Bhavsar
 * SPDX-License-Identifier: Apache-2.0
 */
#include <zephyr/ztest.h>

#include "modes.h"

ZTEST_SUITE(modes, NULL, NULL, NULL, NULL, NULL);

/* MAXM86161 PPG_SR rates with one pulse per sample */
static bool rate_ok(uint8_t hz)
{
	static const uint8_t ok[] = {8, 16, 25, 32, 50, 64, 84, 100, 128, 200};

	for (size_t i = 0; i < ARRAY_SIZE(ok); i++) {
		if (ok[i] == hz) {
			return true;
		}
	}
	return false;
}

ZTEST(modes, test_docked_idle_within_limit)
{
	const struct mode_cfg *m = mode_get(MODE_DOCKED_IDLE);

	zassert_true(m->budget_typ_ua <= DOCKED_IDLE_LIMIT_UA);
	zassert_true(m->budget_wc_ua <= DOCKED_IDLE_LIMIT_UA);
	zassert_equal(m->n_slots, 0, "no LEDs while docked");
	zassert_equal(m->imu_mhz, 0);
	/* the charge policy needs a temperature at least every 10 s */
	zassert_true(m->tmp_period_s <= 10);
}

ZTEST(modes, test_off_body_probe_is_cheap)
{
	const struct mode_cfg *m = mode_get(MODE_OFFBODY);

	zassert_equal(m->n_slots, 1);
	zassert_equal(m->slot[0].led, LED_GREEN, "the probe keeps a green DC for wear detection");
	zassert_true(m->budget_wc_ua < mode_get(MODE_LITE)->budget_typ_ua);
}

ZTEST(modes, test_every_mode_fits_the_maxm86161)
{
	for (int i = 0; i < MODE_COUNT; i++) {
		const struct mode_cfg *m = mode_get(i);
		uint8_t used = 0;

		zassert_not_null(m->name);
		zassert_true(m->n_slots <= MODE_MAX_SLOTS, "%s", m->name);
		zassert_true(m->budget_typ_ua <= m->budget_wc_ua, "%s", m->name);
		zassert_true(m->tmp_period_s >= 1 && m->tmp_period_s <= 10, "%s", m->name);
		if (m->n_slots) {
			/* the module's own rate is a PPG_SR rate; with SMP_AVE the FIFO runs slower */
			zassert_true(mode_sample_hz(m) <= 255 && rate_ok((uint8_t)mode_sample_hz(m)),
				     "%s: %u Hz is not a PPG_SR rate", m->name, mode_sample_hz(m));
			zassert_equal(mode_sample_hz(m) % mode_avg(m), 0, "%s", m->name);
		}
		for (int s = 0; s < m->n_slots; s++) {
			const struct led_slot *l = &m->slot[s];

			/* one PA register per LED: each LED once per sample */
			zassert_false(used & BIT(l->led), "%s repeats LED %u", m->name, l->led);
			used |= BIT(l->led);
			if (l->led == LED_AMBIENT) {
				/* direct ambient: no LED, and only the research modes sample it */
				zassert_equal(l->ma, 0, "%s slot %d", m->name, s);
				zassert_true(mode_is_research(i), "%s samples ambient", m->name);
				continue;
			}
			zassert_true(l->ma > 0 && l->ma <= 124, "%s slot %d", m->name, s);
			if (l->led == LED_GREEN) {
				zassert_true(l->ma <= GREEN_MAX_MA, "%s green %u mA", m->name, l->ma);
			}
		}
		/* the raw stream is 3 bytes per PPG sample; 2 per accelerometer sample in modes 10, 11 */
		if (mode_is_vibration(i)) {
			zassert_equal(m->stream_bps, (m->imu_mhz * 2 + 500) / 1000, "%s", m->name);
		} else if (m->stream_bps) {
			zassert_equal(m->stream_bps, m->n_slots * m->hz * 3, "%s", m->name);
		}
	}
}

ZTEST(modes, test_ml_contract_rates)
{
	/* ML data contract: green at 25 Hz in every worn mode (best tested for HR and HRV),
	 * accelerometer at 12.5 Hz */
	for (int i = MODE_FULL; i <= MODE_SLEEP; i++) {
		const struct mode_cfg *m = mode_get(i);

		zassert_equal(m->hz, 25, "%s", m->name);
		zassert_equal(m->slot[0].led, LED_GREEN, "%s: pulse source is the first slot", m->name);
		zassert_equal(m->imu_mhz, 12500, "%s", m->name);
	}
}

ZTEST(modes, test_lite_duty_cycle)
{
	const struct mode_cfg *m = mode_get(MODE_LITE);
	int on = 0;

	for (uint32_t t = 0; t < 1200; t++) {
		on += mode_optics_on(m, t);
	}
	zassert_equal(on, 300, "30 s in every 120 s");
	zassert_true(mode_optics_on(mode_get(MODE_SMART), 77));
	zassert_false(mode_optics_on(mode_get(MODE_DOCKED_IDLE), 0));
}

ZTEST(modes, test_budget_order_and_values)
{
	zassert_equal(mode_get(MODE_SMART)->budget_typ_ua, 215);
	zassert_true(mode_get(MODE_FULL)->budget_typ_ua > mode_get(MODE_SMART)->budget_typ_ua);
	zassert_true(mode_get(MODE_SMART)->budget_typ_ua > mode_get(MODE_LITE)->budget_typ_ua);
}

ZTEST(modes, test_family_fallbacks)
{
	zassert_equal(mode_sleep_of(MODE_SMART), MODE_SLEEP);
	zassert_equal(mode_lite_of(MODE_FULL), MODE_LITE);
	zassert_equal(mode_lite_of(MODE_SMART), MODE_LITE);
	zassert_equal(mode_lite_of(MODE_SLEEP), MODE_SLEEP);
	zassert_is_null(mode_get(MODE_COUNT));
}

ZTEST(modes, test_research_slot_table_and_stream)
{
	static const struct {
		enum pod_mode mode;
		uint8_t hz;
		uint16_t bps;
	} r[] = {{MODE_RESEARCH_100, 100, 1200}, {MODE_RESEARCH_200, 200, 2400}};

	for (size_t i = 0; i < ARRAY_SIZE(r); i++) {
		const struct mode_cfg *m = mode_get(r[i].mode);

		zassert_true(mode_is_research(r[i].mode));
		zassert_true(mode_user_selectable(r[i].mode), "%s", m->name);
		/* green, IR, red at full's currents, then direct ambient: tags 1 to 4 in the stream */
		zassert_equal(m->n_slots, 4, "%s", m->name);
		zassert_equal(mode_stream_tag(m, LED_GREEN), 1, "%s", m->name);
		zassert_equal(mode_stream_tag(m, LED_IR), 2, "%s", m->name);
		zassert_equal(mode_stream_tag(m, LED_RED), 3, "%s", m->name);
		zassert_equal(mode_stream_tag(m, LED_AMBIENT), 4, "%s", m->name);
		for (uint8_t s = 0; s < 3; s++) {
			zassert_equal(m->slot[s].ma, mode_get(MODE_FULL)->slot[s].ma, "%s", m->name);
		}
		zassert_equal(m->hz, r[i].hz, "%s", m->name);
		zassert_equal(m->imu_mhz, 104000, "%s: LSM6DSOX at 104 Hz", m->name);
		zassert_equal(m->optics_period_s, 0, "%s: no duty cycle", m->name);
		/* 3-byte FIFO words, 4 per sample */
		zassert_equal(m->stream_bps, r[i].bps, "%s", m->name);
		zassert_equal(m->stream_bps, 3 * 4 * m->hz, "%s", m->name);
		/* the 25 Hz filters get whole means of 4 or 8; the rhythm about 12.5 Hz */
		zassert_equal(mode_algo_decim(m) * MODE_ALGO_HZ, m->hz, "%s", m->name);
		zassert_equal(mode_imu_decim(m), 8, "%s", m->name);
		/* the only modes above 1 mA, and the green current sets no new headroom limit */
		zassert_true(m->budget_typ_ua > mode_get(MODE_FULL)->budget_wc_ua, "%s", m->name);
		zassert_true(m->ci_ms <= 30, "%s: the stream needs a short interval", m->name);
	}
	zassert_equal(mode_get(MODE_RESEARCH_100)->budget_typ_ua, 1512);
	zassert_equal(mode_get(MODE_RESEARCH_200)->budget_typ_ua, 2706);
	zassert_true(mode_get(MODE_RESEARCH_200)->budget_wc_ua >
		     mode_get(MODE_RESEARCH_100)->budget_wc_ua);
	/* never the default, never the docked or probe modes */
	zassert_false(mode_is_research(MODE_SMART));
	zassert_false(mode_user_selectable(MODE_DOCKED_IDLE));
	zassert_false(mode_user_selectable(MODE_OFFBODY));
	zassert_false(mode_user_selectable(MODE_COUNT));
	/* the 25 Hz modes are untouched */
	zassert_equal(mode_algo_decim(mode_get(MODE_SMART)), 1);
	zassert_equal(mode_imu_decim(mode_get(MODE_SMART)), 1);
	zassert_equal(mode_algo_decim(mode_get(MODE_OFFBODY)), 1);
	zassert_equal(mode_stream_tag(mode_get(MODE_SMART), LED_AMBIENT), 0);
	/* night and low battery leave research */
	zassert_equal(mode_sleep_of(MODE_RESEARCH_200), MODE_SLEEP);
	zassert_equal(mode_lite_of(MODE_RESEARCH_100), MODE_LITE);
}

ZTEST(modes, test_averaged_research_modes)
{
	static const struct {
		enum pod_mode mode;
		uint8_t out_hz, avg;
		uint16_t bps;
	} r[] = {{MODE_RESEARCH_AVG50, 50, 4, 600}, {MODE_RESEARCH_AVG25, 25, 8, 300}};
	const struct mode_cfg *m7 = mode_get(MODE_RESEARCH_200);

	for (size_t i = 0; i < ARRAY_SIZE(r); i++) {
		const struct mode_cfg *m = mode_get(r[i].mode);

		zassert_true(mode_is_research(r[i].mode), "%s", m->name);
		zassert_true(mode_user_selectable(r[i].mode), "%s", m->name);
		/* mode 7's slot table and module rate, averaged on the chip */
		zassert_equal(m->n_slots, m7->n_slots, "%s", m->name);
		for (uint8_t s = 0; s < m->n_slots; s++) {
			zassert_equal(m->slot[s].led, m7->slot[s].led, "%s slot %u", m->name, s);
			zassert_equal(m->slot[s].ma, m7->slot[s].ma, "%s slot %u", m->name, s);
		}
		zassert_equal(mode_stream_tag(m, LED_AMBIENT), 4, "%s", m->name);
		zassert_equal(mode_sample_hz(m), 200, "%s samples at 200 Hz", m->name);
		zassert_equal(mode_avg(m), r[i].avg, "%s", m->name);
		/* the header's rate byte and the stream are the output rate */
		zassert_equal(m->hz, r[i].out_hz, "%s", m->name);
		zassert_equal(m->stream_bps, r[i].bps, "%s", m->name);
		zassert_equal(m->stream_bps * r[i].avg, m7->stream_bps, "%s: 1/avg of mode 7", m->name);
		zassert_equal(mode_algo_decim(m) * MODE_ALGO_HZ, m->hz, "%s", m->name);
		zassert_equal(m->imu_mhz, 104000, "%s", m->name);
		/* the same exposures as mode 7, so about its optical current; less radio */
		zassert_true(m->budget_typ_ua < m7->budget_typ_ua, "%s", m->name);
		zassert_true(m->budget_typ_ua > 2000, "%s", m->name);
		zassert_true(m->budget_typ_ua <= m->budget_wc_ua, "%s", m->name);
	}
	zassert_equal(mode_get(MODE_RESEARCH_AVG50)->budget_typ_ua, 2443);
	zassert_equal(mode_get(MODE_RESEARCH_AVG25)->budget_typ_ua, 2408);
	/* point-sampled modes average nothing */
	zassert_equal(mode_avg(mode_get(MODE_FULL)), 1);
	zassert_equal(mode_avg(m7), 1);
	zassert_equal(mode_sample_hz(mode_get(MODE_SMART)), 25);
	zassert_equal(mode_lite_of(MODE_RESEARCH_AVG25), MODE_LITE);
}

ZTEST(modes, test_vibration_modes)
{
	static const struct {
		enum pod_mode mode;
		uint32_t imu_mhz;
		uint16_t typ;
	} v[] = {{MODE_RESEARCH_VIB3K3, 3333333, 1235}, {MODE_RESEARCH_VIB6K7, 6666667, 1898}};

	zassert_equal(MODE_RESEARCH_VIB3K3, 10, "the GATT value");
	zassert_equal(MODE_RESEARCH_VIB6K7, 11);
	for (size_t i = 0; i < ARRAY_SIZE(v); i++) {
		const struct mode_cfg *m = mode_get(v[i].mode);

		zassert_true(mode_is_vibration(v[i].mode));
		zassert_true(mode_is_research(v[i].mode), "%s", m->name);
		zassert_true(mode_user_selectable(v[i].mode), "%s", m->name);
		/* no LEDs, no PPG: the radio and the current are the accelerometer's */
		zassert_equal(m->n_slots, 0, "%s", m->name);
		zassert_equal(m->hz, 0, "%s", m->name);
		zassert_equal(m->imu_mhz, v[i].imu_mhz, "%s", m->name);
		zassert_equal(m->ci_ms, 15, "%s: the shortest iOS interval", m->name);
		zassert_equal(m->budget_typ_ua, v[i].typ, "%s", m->name);
		zassert_true(m->budget_typ_ua > mode_get(MODE_FULL)->budget_wc_ua, "%s", m->name);
		zassert_false(mode_optics_on(m, 0), "%s", m->name);
		zassert_equal(mode_lite_of(v[i].mode), MODE_LITE);
		zassert_equal(mode_sleep_of(v[i].mode), MODE_SLEEP);
		zassert_equal(mode_imu_decim(m), 255, "%s: saturates", m->name);
	}
	zassert_true(mode_get(MODE_RESEARCH_VIB6K7)->budget_wc_ua >
		     mode_get(MODE_RESEARCH_VIB3K3)->budget_wc_ua);
	for (int i = 0; i < MODE_COUNT; i++) {
		zassert_equal(mode_is_vibration(i),
			      i == MODE_RESEARCH_VIB3K3 || i == MODE_RESEARCH_VIB6K7);
	}
}
```

## src/test_ntc.c
```c
/*
 * Copyright (c) 2026 Het Bhavsar
 * SPDX-License-Identifier: Apache-2.0
 *
 * ntc.c against Murata's NCP03XH103F05RL resistance-temperature table (NC-R8021, centre
 * values): the table points themselves, interpolation between them, the charge-policy
 * limits through the 12-bit SAADC, and open or shorted sensors.
 */
#include <math.h>
#include <stdlib.h>
#include <zephyr/ztest.h>

#include "ntc.h"

ZTEST_SUITE(ntc, NULL, NULL, NULL, NULL, NULL);

#define FS 4096

/* the SAADC code for an NTC resistance under the 10 kOhm divider resistor */
static int32_t code_of_ohm(double r)
{
	return (int32_t)lround(FS * r / (r + 10000.0));
}

ZTEST(ntc, test_murata_points)
{
	/* Murata centre values, ohms */
	static const struct {
		int32_t t_c;
		uint32_t r;
	} pts[] = {{-40, 195652}, {-10, 42506}, {0, 27219}, {10, 17926}, {25, 10000},
		   {30, 8315},    {37, 6475},   {45, 4917}, {85, 1452}};

	for (size_t i = 0; i < ARRAY_SIZE(pts); i++) {
		zassert_within(ntc_temp_cc_of_ohm(pts[i].r), pts[i].t_c * 100, 1, "%d C",
			       pts[i].t_c);
	}
}

ZTEST(ntc, test_interpolates_between_points)
{
	/* 36.5 C sits between 6.7067 kOhm (36 C) and 6.4751 kOhm (37 C) */
	zassert_within(ntc_temp_cc_of_ohm((6707 + 6475) / 2), 3650, 2);
	/* falls monotonically across the whole table */
	int32_t prev = INT32_MIN;

	for (uint32_t r = 195000; r > 1500; r = r * 99 / 100) {
		int32_t t = ntc_temp_cc_of_ohm(r);

		zassert_true(t > prev, "%u ohm", r);
		prev = t;
	}
}

ZTEST(ntc, test_25c_is_half_scale)
{
	zassert_equal(ntc_resistance_ohm(FS / 2, FS), 10000);
	zassert_within(ntc_temp_cc(FS / 2, FS), 2500, 1);
}

ZTEST(ntc, test_policy_limits)
{
	/* the 12-bit code resolves the charge limits to better than 0.1 C */
	zassert_within(ntc_temp_cc(code_of_ohm(27219), FS), 0, 10);
	zassert_within(ntc_temp_cc(code_of_ohm(17926), FS), 1000, 10);
	zassert_within(ntc_temp_cc(code_of_ohm(4917), FS), 4500, 10);
}

ZTEST(ntc, test_resolution_near_body_temperature)
{
	/* about 30 mK per code near 33 C; allow 50 mK */
	int32_t c = code_of_ohm(7461); /* 33 C */

	zassert_true(abs(ntc_temp_cc(c, FS) - ntc_temp_cc(c + 1, FS)) <= 5);
}

ZTEST(ntc, test_open_short_and_range)
{
	zassert_equal(ntc_temp_cc(0, FS), NTC_INVALID, "shorted");
	zassert_equal(ntc_temp_cc(FS, FS), NTC_INVALID, "open");
	zassert_equal(ntc_temp_cc(-12, FS), NTC_INVALID);
	zassert_equal(ntc_temp_cc(4090, FS), NTC_INVALID, "above 195 kOhm: below -40 C");
	zassert_equal(ntc_temp_cc_of_ohm(1400), NTC_INVALID, "above 85 C");
	zassert_equal(ntc_temp_cc_of_ohm(195652), -4000);
	zassert_equal(ntc_temp_cc_of_ohm(1452), 8500);
}
```

## src/test_power_sm.c
```c
/*
 * Copyright (c) 2026 Het Bhavsar
 * SPDX-License-Identifier: Apache-2.0
 */
#include <zephyr/ztest.h>

#include "power_sm.h"

static struct power_sm sm;
static struct power_sm_in in;
static struct power_sm_out out;

static void before(void *f)
{
	ARG_UNUSED(f);
	struct power_sm_cfg cfg = POWER_SM_CFG_DEFAULT;

	power_sm_init(&sm, &cfg);
	in = (struct power_sm_in){
		.now_ms = 1000,
		.pg_low = false,
		.vsys_valid = true,
		.vsys_mv = 3900,
		.temps = {.primary = {.valid = true, .cc = 3300}},
		.charger = {.valid = true},
		.user_mode = MODE_SMART,
		.worn = true,
	};
}

ZTEST_SUITE(power_sm, NULL, NULL, before, NULL, NULL);

static void step(int n)
{
	for (int i = 0; i < n; i++) {
		in.now_ms += 1000;
		in.temps.primary.at_ms = in.now_ms;
		power_sm_step(&sm, &in, &out);
	}
}

ZTEST(power_sm, test_worn_uses_user_mode)
{
	step(1);
	zassert_equal(out.state, POD_WORN);
	zassert_equal(out.mode, MODE_SMART);
	zassert_false(out.poweroff);
	zassert_false(out.chg_disable);
	zassert_equal(out.chg, CHG_UNDOCKED);
}

ZTEST(power_sm, test_night_and_low_battery)
{
	in.night = true;
	step(1);
	zassert_equal(out.mode, MODE_SLEEP);
	in.night = false;
	in.vsys_mv = 3420;
	step(1);
	zassert_equal(out.batt, BATT_LOW);
	zassert_equal(out.mode, MODE_LITE);
	in.user_mode = MODE_FULL;
	step(1);
	zassert_equal(out.mode, MODE_LITE);
}

ZTEST(power_sm, test_cutoff_powers_off_and_dock_releases)
{
	in.vsys_mv = 3280;
	step(3);
	zassert_equal(out.state, POD_POWEROFF);
	zassert_true(out.poweroff);

	/* /PG wakes the nRF from System OFF: the pod boots on the Plinth */
	in.pg_low = true;
	in.vsys_valid = false;
	step(2);
	zassert_equal(out.state, POD_DOCKED);
	zassert_false(out.poweroff);
	zassert_equal(out.mode, MODE_DOCKED_IDLE);
	zassert_equal(out.batt, BATT_LOW);
}

ZTEST(power_sm, test_docked_idle_and_charge_state)
{
	in.pg_low = true;
	step(2);
	zassert_true(out.docked);
	zassert_equal(out.mode, MODE_DOCKED_IDLE);
	zassert_equal(out.chg, CHG_CHARGING);

	in.charger.done = true;
	step(1);
	zassert_equal(out.chg, CHG_FULL);
}

ZTEST(power_sm, test_cold_dock_lowers_current)
{
	in.pg_low = true;
	in.temps.primary.cc = 500;
	step(2);
	zassert_true(out.chg_cold);
	zassert_false(out.chg_disable);
	zassert_equal(out.chg, CHG_COLD_LIMITED);
}

ZTEST(power_sm, test_hot_dock_disables)
{
	in.pg_low = true;
	in.temps.primary.cc = 4900;
	step(2);
	zassert_true(out.chg_disable);
	zassert_equal(out.chg, CHG_TEMP_BLOCKED);
	zassert_equal(out.band, CHG_BAND_HOT);

	/* lifted while hot: nothing to disable */
	in.pg_low = false;
	step(2);
	zassert_false(out.docked);
	zassert_false(out.chg_disable);
}

/* On the Plinth VSYS is regulated at 4.5 V, or anything while the charger starts: it is
 * never a cell voltage, so it cannot cut the pod off */
ZTEST(power_sm, test_no_cutoff_while_docked)
{
	in.pg_low = true;
	in.vsys_mv = 3100;
	step(10);
	zassert_false(out.poweroff);
	zassert_equal(out.state, POD_DOCKED);
}

ZTEST(power_sm, test_off_body_uses_probe_mode)
{
	in.worn = false;
	step(1);
	zassert_equal(out.state, POD_OFFBODY);
	zassert_equal(out.mode, MODE_OFFBODY);
	/* the cut-off still applies off the body */
	in.vsys_mv = 3280;
	step(3);
	zassert_equal(out.state, POD_POWEROFF);
	zassert_true(out.poweroff);
}

ZTEST(power_sm, test_invalid_user_mode_falls_back)
{
	zassert_equal(power_sm_pick_mode(POD_WORN, BATT_OK, MODE_DOCKED_IDLE, false), MODE_SMART);
	zassert_equal(power_sm_pick_mode(POD_POWEROFF, BATT_CUTOFF, MODE_FULL, false),
		      MODE_DOCKED_IDLE);
	zassert_str_equal(pod_state_name(POD_DOCKED), "docked");
	zassert_str_equal(pod_state_name(POD_POWEROFF), "power-off");
}

ZTEST(power_sm, test_fit_holds_green_before_worn)
{
	/* the fit guide runs before wear detection says worn: green at 25 Hz, no duty */
	in.worn = false;
	in.fit = true;
	step(1);
	zassert_equal(out.state, POD_OFFBODY);
	zassert_equal(out.mode, MODE_SMART);
	/* and over a duty-cycled user mode, at night too */
	in.worn = true;
	in.user_mode = MODE_LITE;
	in.night = true;
	step(1);
	zassert_equal(out.mode, MODE_SMART);
	/* never on the Plinth */
	in.pg_low = true;
	step(3);
	zassert_equal(out.state, POD_DOCKED);
	zassert_equal(out.mode, MODE_DOCKED_IDLE);
	/* off again: back to the probe */
	in.pg_low = false;
	in.fit = false;
	in.worn = false;
	step(3);
	zassert_equal(out.mode, MODE_OFFBODY);
}

ZTEST(power_sm, test_research_mode_rules)
{
	/* worn with headroom: the research mode runs */
	in.user_mode = MODE_RESEARCH_200;
	step(1);
	zassert_equal(out.state, POD_WORN);
	zassert_equal(out.mode, MODE_RESEARCH_200);
	/* below the green limit it gives way to full, never to a shifted slot table */
	in.green_low = true;
	step(1);
	zassert_equal(out.mode, MODE_FULL);
	in.green_low = false;
	step(1);
	zassert_equal(out.mode, MODE_RESEARCH_200);
	/* night and low battery as for full */
	in.night = true;
	step(1);
	zassert_equal(out.mode, MODE_SLEEP);
	in.night = false;
	in.vsys_mv = 3420;
	step(1);
	zassert_equal(out.mode, MODE_LITE);
	in.vsys_mv = 3900;
	/* off the body: the probe */
	in.user_mode = MODE_RESEARCH_100;
	in.worn = false;
	step(1);
	zassert_equal(out.mode, MODE_OFFBODY);
	/* never on the Plinth */
	in.worn = true;
	in.pg_low = true;
	step(3);
	zassert_equal(out.state, POD_DOCKED);
	zassert_equal(out.mode, MODE_DOCKED_IDLE);
	zassert_equal(power_sm_pick_mode(POD_DOCKED, BATT_OK, MODE_RESEARCH_100, false),
		      MODE_DOCKED_IDLE);
	zassert_equal(power_sm_pick_mode(POD_WORN, BATT_OK, MODE_RESEARCH_100, false),
		      MODE_RESEARCH_100);
	zassert_equal(power_sm_pick_mode(POD_WORN, BATT_OK, MODE_COUNT, false), MODE_SMART);
	/* the averaged modes follow the same rules */
	zassert_equal(power_sm_pick_mode(POD_WORN, BATT_OK, MODE_RESEARCH_AVG50, false),
		      MODE_RESEARCH_AVG50);
	zassert_equal(power_sm_pick_mode(POD_DOCKED, BATT_OK, MODE_RESEARCH_AVG25, false),
		      MODE_DOCKED_IDLE);
	zassert_equal(power_sm_pick_mode(POD_WORN, BATT_LOW, MODE_RESEARCH_AVG25, false), MODE_LITE);
	in.pg_low = false;
	in.user_mode = MODE_RESEARCH_AVG50;
	in.green_low = true;
	step(3);
	zassert_equal(out.state, POD_WORN);
	zassert_equal(out.mode, MODE_FULL);
}

ZTEST(power_sm, test_vibration_mode_rules)
{
	in.user_mode = MODE_RESEARCH_VIB6K7;
	step(1);
	zassert_equal(out.state, POD_WORN);
	zassert_equal(out.mode, MODE_RESEARCH_VIB6K7);
	/* no LEDs: the green headroom limit does not move it to full */
	in.green_low = true;
	step(1);
	zassert_equal(out.mode, MODE_RESEARCH_VIB6K7);
	in.green_low = false;
	/* night and low battery as for the other research modes */
	in.night = true;
	step(1);
	zassert_equal(out.mode, MODE_SLEEP);
	in.night = false;
	in.vsys_mv = 3420;
	step(1);
	zassert_equal(out.mode, MODE_LITE);
	in.vsys_mv = 3900;
	in.user_mode = MODE_RESEARCH_VIB3K3;
	step(1);
	zassert_equal(out.mode, MODE_RESEARCH_VIB3K3);
	/* off the body: the probe; on the Plinth: docked idle */
	in.worn = false;
	step(1);
	zassert_equal(out.mode, MODE_OFFBODY);
	in.worn = true;
	in.pg_low = true;
	step(3);
	zassert_equal(out.mode, MODE_DOCKED_IDLE);
	zassert_equal(power_sm_pick_mode(POD_DOCKED, BATT_OK, MODE_RESEARCH_VIB6K7, false),
		      MODE_DOCKED_IDLE);
	/* the fit guide still wins */
	in.pg_low = false;
	step(3);
	in.fit = true;
	step(1);
	zassert_equal(out.mode, MODE_SMART);
	in.fit = false;
}
```

## src/test_soc_est.c
```c
/*
 * Copyright (c) 2026 Het Bhavsar
 * SPDX-License-Identifier: Apache-2.0
 */
#include <zephyr/ztest.h>

#include "soc_est.h"

static struct soc s;

static void before(void *f)
{
	ARG_UNUSED(f);
	struct soc_cfg cfg = SOC_CFG_DEFAULT;

	soc_init(&s, &cfg);
}

ZTEST_SUITE(soc, NULL, NULL, before, NULL, NULL);

ZTEST(soc, test_ocv_curve)
{
	zassert_equal(soc_from_ocv_mv(2900), 0);
	zassert_equal(soc_from_ocv_mv(3820), 500);
	zassert_equal(soc_from_ocv_mv(4190), 1000);
	zassert_equal(soc_from_ocv_mv(4300), 1000);
	zassert_within(soc_from_ocv_mv(3980), 750, 1);
}

ZTEST(soc, test_unprimed_reads_zero)
{
	zassert_equal(soc_percent(&s), 0);
}

ZTEST(soc, test_first_reading_primes_with_ir_correction)
{
	/* 3.81 V under 5 mA through 2 ohm is 3.82 V open circuit: 50 % */
	soc_on_vbat(&s, 3810, 5000);
	zassert_equal(soc_percent(&s), 50);
}

ZTEST(soc, test_coulomb_count)
{
	soc_on_vbat(&s, 3820, 0); /* 50 % = 15 mAh */
	/* 0.30 mA for 10 h = 3 mAh = 10 % of 30 mAh */
	for (int i = 0; i < 36000; i++) {
		soc_flow(&s, 1000, 300, 0);
	}
	zassert_equal(soc_percent(&s), 40);
}

ZTEST(soc, test_charge_counts_up_and_full_snaps)
{
	soc_on_vbat(&s, 3690, 0); /* 20 % */
	for (int i = 0; i < 1800; i++) {
		soc_flow(&s, 1000, 20, 14850); /* 30 min at 14.85 mA: +7.4 mAh = +25 % */
	}
	zassert_within(soc_percent(&s), 45, 1);
	soc_full(&s);
	zassert_equal(soc_percent(&s), 100);
	soc_flow(&s, 1000, 0, 15000);
	zassert_equal(soc_percent(&s), 100, "no count above full");
}

ZTEST(soc, test_voltage_pulls_the_count_only_at_light_load)
{
	soc_on_vbat(&s, 3820, 0); /* the count says 50 % */
	/* the cell actually reads 3.69 V at rest: 20 % */
	for (int i = 0; i < 10; i++) {
		soc_on_vbat(&s, 3690, 900); /* heavy load: no correction */
	}
	zassert_equal(soc_percent(&s), 50);
	for (int i = 0; i < 300; i++) {
		soc_on_vbat(&s, 3690, 100);
	}
	zassert_within(soc_percent(&s), 20, 1);
}

ZTEST(soc, test_never_negative)
{
	soc_on_vbat(&s, 3350, 0);
	for (int i = 0; i < 100000; i++) {
		soc_flow(&s, 1000, 1000, 0);
	}
	zassert_equal(soc_percent(&s), 0);
}
```

## src/test_vinpat.c
```c
/*
 * Copyright (c) 2026 Het Bhavsar
 * SPDX-License-Identifier: Apache-2.0
 *
 * The case's VIN patterns as the pod sees them on /PG. The timings are the case's
 * (firmware/case/src/case_sm.h: 200 ms off, 300 ms on); the case tests run the same
 * detector against the case state machine's own output.
 */
#include <zephyr/ztest.h>

#include "vinpat.h"

static struct vinpat v;

static void before(void *f)
{
	ARG_UNUSED(f);
	static const struct vinpat_cfg cfg = VINPAT_CFG_DEFAULT;

	vinpat_init(&v, &cfg, true);
}

ZTEST_SUITE(vinpat, NULL, NULL, before, NULL, NULL);

/* VIN off at t for `off` ms: the event at VIN's return */
static enum vinpat_ev pulse(uint32_t t, uint32_t off)
{
	zassert_equal(vinpat_edge(&v, false, t), VINPAT_NONE);
	return vinpat_edge(&v, true, t + off);
}

ZTEST(vinpat, test_soft_reset_pattern)
{
	zassert_equal(pulse(10000, 200), VINPAT_NONE);
	zassert_equal(pulse(10500, 200), VINPAT_CASE, "two pulses read as the signature");
	zassert_equal(pulse(11000, 200), VINPAT_RESET);
}

ZTEST(vinpat, test_signature_marks_case_until_a_long_drop)
{
	zassert_false(vinpat_on_case(&v));
	zassert_equal(pulse(10000, 200), VINPAT_NONE);
	zassert_equal(pulse(10500, 200), VINPAT_CASE);
	zassert_true(vinpat_on_case(&v));

	zassert_equal(vinpat_edge(&v, false, 20000), VINPAT_NONE);
	zassert_false(vinpat_on_case(&v), "no VIN: not fed by anything");
	zassert_equal(vinpat_edge(&v, true, 20200), VINPAT_NONE);
	zassert_true(vinpat_on_case(&v), "one pulse keeps it");

	zassert_equal(pulse(30000, 5000), VINPAT_NONE);
	zassert_false(vinpat_on_case(&v), "a lift, or the case let go");
}

ZTEST(vinpat, test_bounce_is_ignored)
{
	zassert_equal(pulse(10000, 200), VINPAT_NONE);
	for (uint32_t t = 10300; t < 10400; t += 20) {
		zassert_equal(pulse(t, 5), VINPAT_NONE);
	}
	zassert_equal(pulse(10500, 200), VINPAT_CASE, "bounce neither counts nor clears");
}

ZTEST(vinpat, test_limits_of_a_pulse)
{
	zassert_equal(pulse(10000, 99), VINPAT_NONE);
	zassert_equal(pulse(10500, 99), VINPAT_NONE, "too short twice: nothing");
	zassert_equal(pulse(11000, 100), VINPAT_NONE);
	zassert_equal(pulse(11500, 400), VINPAT_CASE, "100 and 400 ms both count");
	zassert_equal(pulse(12500, 401), VINPAT_NONE);
	zassert_false(vinpat_on_case(&v), "401 ms is a long drop");
}

ZTEST(vinpat, test_long_drop_clears_the_count)
{
	zassert_equal(pulse(10000, 200), VINPAT_NONE);
	zassert_equal(pulse(10300, 600), VINPAT_NONE);
	zassert_equal(pulse(11000, 200), VINPAT_NONE);
	zassert_equal(pulse(11500, 200), VINPAT_CASE, "no reset across a lift");
}

ZTEST(vinpat, test_slow_pulses_do_not_reset)
{
	zassert_equal(pulse(10000, 200), VINPAT_NONE);
	zassert_equal(pulse(11500, 200), VINPAT_CASE);
	zassert_equal(pulse(13000, 200), VINPAT_CASE, "the first is out of the 2 s window");
	zassert_equal(pulse(15000, 200), VINPAT_NONE, "both earlier ones are out");
}

ZTEST(vinpat, test_signature_then_reset_spaced_as_the_case_does)
{
	/* signature at 3 s after VIN on; the pattern 2.5 s after it ends */
	zassert_equal(pulse(13000, 200), VINPAT_NONE);
	zassert_equal(pulse(13500, 200), VINPAT_CASE);
	zassert_equal(pulse(16200, 200), VINPAT_NONE, "not counted with the signature");
	zassert_equal(pulse(16700, 200), VINPAT_CASE);
	zassert_equal(pulse(17200, 200), VINPAT_RESET);
}

ZTEST(vinpat, test_power_up_and_repeated_levels)
{
	static const struct vinpat_cfg cfg = VINPAT_CFG_DEFAULT;

	vinpat_init(&v, &cfg, false);
	zassert_equal(vinpat_edge(&v, true, 5), VINPAT_NONE, "VIN at power-up");
	zassert_equal(vinpat_edge(&v, true, 10), VINPAT_NONE);
	zassert_equal(vinpat_edge(&v, false, 1000), VINPAT_NONE);
	zassert_equal(vinpat_edge(&v, false, 1100), VINPAT_NONE, "same level twice");
	zassert_equal(vinpat_edge(&v, true, 1200), VINPAT_NONE, "timed from the first edge");
	zassert_equal(pulse(1500, 200), VINPAT_CASE);
}
```

## src/test_wear.c
```c
/*
 * Copyright (c) 2026 Het Bhavsar
 * SPDX-License-Identifier: Apache-2.0
 *
 * The cases of app/python/tests/test_wear.py on the port, with the firmware's own part:
 * one on-skin reference per LED, learned while worn with a pulse, cleared on the dock and
 * at off-body.
 */
#include <zephyr/ztest.h>

#include "modes.h"
#include "wear.h"

static struct wear w;

static void before(void *f)
{
	ARG_UNUSED(f);
	struct wear_cfg cfg = WEAR_CFG_DEFAULT;

	wear_init(&w, &cfg);
}

ZTEST_SUITE(wear, NULL, NULL, before, NULL, NULL);

#define SKIN 10000.0f /* on-skin level, counts per mA */
#define AIR  500.0f   /* 0.05 of it */

static bool run_led(int secs, uint8_t led, float dc, bool pulse, float mot, float temp)
{
	bool r = w.worn;

	for (int i = 0; i < secs; i++) {
		r = wear_update(&w, led, true, dc, pulse, mot, true, temp);
	}
	return r;
}

static bool run(int secs, float dc, bool pulse, float mot, float temp)
{
	return run_led(secs, LED_GREEN, dc, pulse, mot, temp);
}

/* the first pulse-present minute while worn sets the green reference */
static void learn_green(void)
{
	zassert_true(run(60, SKIN, true, 5, 34.0f));
	zassert_true(wear_has_ref(&w, LED_GREEN));
}

ZTEST(wear, test_starts_worn_and_stays)
{
	zassert_false(wear_has_ref(&w, LED_GREEN));
	zassert_true(run(600, SKIN, true, 5, 34.0f));
}

ZTEST(wear, test_learns_on_skin_reference)
{
	/* a darker skin: 2500 counts/mA */
	zassert_true(run(59, 2500.0f, true, 5, 34.0f));
	zassert_false(wear_has_ref(&w, LED_GREEN), "59 s are not a minute");
	zassert_true(run(1, 2500.0f, true, 5, 34.0f));
	zassert_within(w.dc_ref[LED_GREEN], 2500.0f, 1.0f);
	zassert_false(run(4, 100.0f, false, 5, 34.0f), "air is dark against the learned level");
}

ZTEST(wear, test_lifted_into_air_goes_dark)
{
	learn_green();
	zassert_true(run(3, AIR, false, 30, 34.0f), "3 s dark is not enough");
	zassert_false(run(1, AIR, false, 30, 34.0f));
	zassert_false(wear_has_ref(&w, LED_GREEN), "off-body clears the reference");
}

/* wear.py test_no_reference_uses_pulse_and_temperature_only */
ZTEST(wear, test_no_reference_uses_pulse_and_temperature_only)
{
	/* dark, warm and moving with no reference: the dark path is skipped */
	zassert_true(run(120, AIR, false, 30, 34.0f));
	/* still and cool: the no-pulse path takes it off after 60 s without a pulse */
	before(NULL);
	zassert_true(run(59, AIR, false, 2, 26.0f));
	zassert_false(run(1, AIR, false, 2, 26.0f));
	/* back on: a pulse alone, even in the dark, no lit and confirm step */
	zassert_true(run(1, AIR, true, 5, 33.0f));
}

ZTEST(wear, test_exercise_masks_pulse_but_stays_worn)
{
	learn_green();
	/* walking: no pulse presence (the step artefact), moving, warm and lit */
	zassert_true(run(900, SKIN, false, 80, 34.5f));
}

ZTEST(wear, test_on_a_table_still_and_cool)
{
	learn_green();
	zassert_true(run(59, SKIN, false, 2, 26.0f));
	zassert_false(run(1, SKIN, false, 2, 26.0f));
}

ZTEST(wear, test_cooling_fast_counts_as_cool)
{
	/* 33 C but falling 0.5 C a minute, still, no pulse */
	bool r = true;

	for (int i = 0; i < 60; i++) {
		r = wear_update(&w, LED_GREEN, true, SKIN, false, 2, true, 33.0f - i * 0.5f / 60.0f);
	}
	zassert_false(r);
}

ZTEST(wear, test_pocket_long_no_pulse_not_warm)
{
	/* moving cloth reflects, no pulse, 31 C: off after 300 s */
	zassert_true(run(299, SKIN, false, 60, 31.0f));
	zassert_false(run(1, SKIN, false, 60, 31.0f));
}

ZTEST(wear, test_back_on_with_a_pulse_after_off_body)
{
	learn_green();
	run(4, AIR, false, 5, 30.0f);
	zassert_false(w.worn);
	zassert_false(run(5, SKIN, false, 5, 33.0f), "lit, but no pulse yet");
	zassert_true(run(1, SKIN, true, 5, 33.0f));
	/* and the reference is learned again in the new wear's first pulse minute */
	zassert_false(wear_has_ref(&w, LED_GREEN));
	run(60, SKIN, true, 5, 34.0f);
	zassert_true(wear_has_ref(&w, LED_GREEN));
}

/* Low battery: green swaps to IR. The worn state carries over, IR has no reference yet, so
 * the IR level cannot take the pod off until IR has its own minute. */
ZTEST(wear, test_swap_to_ir_keeps_worn_and_learns_ir)
{
	learn_green();
	/* IR reads 0.1 of green's counts per mA: against green's reference that is dark */
	zassert_true(run_led(30, LED_IR, 0.1f * SKIN, false, 30, 34.0f), "no IR reference: not dark");
	zassert_false(wear_has_ref(&w, LED_IR));
	zassert_true(run_led(60, LED_IR, 0.1f * SKIN, true, 5, 34.0f));
	zassert_true(wear_has_ref(&w, LED_IR));
	zassert_within(w.dc_ref[LED_IR], 0.1f * SKIN, 1.0f);
	zassert_true(wear_has_ref(&w, LED_GREEN), "green keeps its own");
	/* IR into the air: dark against the IR reference */
	zassert_false(run_led(4, LED_IR, 0.01f * SKIN, false, 30, 34.0f));
}

ZTEST(wear, test_swap_mid_minute_restarts_learning)
{
	run(30, SKIN, true, 5, 34.0f);
	run_led(30, LED_IR, 2000.0f, true, 5, 34.0f);
	zassert_false(wear_has_ref(&w, LED_GREEN));
	zassert_false(wear_has_ref(&w, LED_IR), "30 s on IR is not a minute");
	run_led(30, LED_IR, 2000.0f, true, 5, 34.0f);
	zassert_true(wear_has_ref(&w, LED_IR));
	zassert_within(w.dc_ref[LED_IR], 2000.0f, 1.0f, "only IR seconds in the IR mean");
}

ZTEST(wear, test_dock_clears_references)
{
	learn_green();
	wear_restart(&w);
	zassert_true(w.worn);
	zassert_false(wear_has_ref(&w, LED_GREEN));
	zassert_false(wear_has_ref(&w, LED_IR));
}

ZTEST(wear, test_no_sample_holds_state)
{
	learn_green();
	run(4, AIR, false, 5, 30.0f);
	for (int i = 0; i < 10; i++) {
		zassert_false(wear_update(&w, LED_GREEN, false, SKIN, true, 5, true, 33.0f));
	}
}
```
