## CMakeLists.txt
```
# SPDX-License-Identifier: Apache-2.0
cmake_minimum_required(VERSION 3.20.0)
find_package(Zephyr REQUIRED HINTS $ENV{ZEPHYR_BASE})
project(atrium_app_tests)

# Reference vectors from app/python/make_test_vectors.py (atrium_ml, Atrium synthetic signals;
# the mlc_config program also carries ST's BSD-3 notice, see src/mlc.c)
set(VEC ${CMAKE_CURRENT_SOURCE_DIR}/vectors)
foreach(case rest_64bpm walk_72bpm_steps108 run_140bpm_steps168 hrv_rest_58bpm_rmssd45 offbody_noise)
  foreach(kind input hr hrv rmssd)
    generate_inc_file_for_target(app ${VEC}/${case}_${kind}.csv
      ${ZEPHYR_BINARY_DIR}/include/generated/vectors/${case}_${kind}.inc)
  endforeach()
endforeach()
foreach(case still head_motion walk run)
  foreach(kind input levels class)
    generate_inc_file_for_target(app ${VEC}/mlc_${case}_${kind}.csv
      ${ZEPHYR_BINARY_DIR}/include/generated/vectors/mlc_${case}_${kind}.inc)
  endforeach()
endforeach()
generate_inc_file_for_target(app ${VEC}/mlc_config.csv
  ${ZEPHYR_BINARY_DIR}/include/generated/vectors/mlc_config.inc)
foreach(case r045 r070 moved low_perfusion)
  foreach(kind input windows burst)
    generate_inc_file_for_target(app ${VEC}/spo2_${case}_${kind}.csv
      ${ZEPHYR_BINARY_DIR}/include/generated/vectors/spo2_${case}_${kind}.inc)
  endforeach()
endforeach()
foreach(case good weak noisy moving saturated dark)
  foreach(kind _input "")
    generate_inc_file_for_target(app ${VEC}/fit_${case}${kind}.csv
      ${ZEPHYR_BINARY_DIR}/include/generated/vectors/fit_${case}${kind}.inc)
  endforeach()
endforeach()

set(FW ${CMAKE_CURRENT_SOURCE_DIR}/../..)
target_include_directories(app PRIVATE ${FW}/src ${FW}/src/power ${FW}/src/ble ${FW}/drivers/maxm86161
  ${FW}/drivers/bq21061)
target_sources(app PRIVATE
  ${FW}/src/activity.c
  ${FW}/src/log_record.c
  ${FW}/src/logpack.c
  ${FW}/src/logxfer.c
  ${FW}/src/epoch.c
  ${FW}/src/pulse.c
  ${FW}/src/hrv.c
  ${FW}/src/mlc.c
  ${FW}/src/spo2.c
  ${FW}/src/sigq.c
  ${FW}/src/vibcap.c
  ${FW}/src/power/modes.c
  ${FW}/src/dfu_health.c
  ${FW}/src/ble/gatt_encode.c
  ${FW}/drivers/maxm86161/maxm86161_regs.c
  ${FW}/drivers/bq21061/bq21061_regs.c
  src/test_activity.c
  src/test_gatt_encode.c
  src/test_hrv.c
  src/test_ml_vectors.c
  src/test_dfu_health.c
  src/test_log_record.c
  src/test_logpack.c
  src/test_logxfer.c
  src/test_epoch.c
  src/test_maxm86161.c
  src/test_bq21061.c
  src/test_mlc.c
  src/test_spo2.c
  src/test_pulse.c
  src/test_sigq.c
  src/test_ble_policy.c
  src/test_vibcap.c
)
```

## prj.conf
```kconfig
CONFIG_ZTEST=y
CONFIG_ZTEST_STACK_SIZE=8192
CONFIG_CRC=y
```

## src/log_vec.h
```c
/*
 * Copyright (c) 2026 Het Bhavsar
 * SPDX-License-Identifier: Apache-2.0
 *
 * Synthetic epoch k, the same in app/python/atrium_ml/logrec.py terms (the vectors in
 * test_log_record.c and test_logpack.c come from logrec.encode and logrec.pack_pages on it).
 */
#ifndef ATRIUM_TEST_LOG_VEC_H_
#define ATRIUM_TEST_LOG_VEC_H_

#include "log_record.h"

static inline struct log_record vec_epoch(int k)
{
	struct log_record r = {
		.bpm = k % 7 ? (float)(50 + k % 60) : 0.0f,
		.conf = (float)(k % 16) / 15.0f,
		.on_skin = k & 1,
		.pulse_ir = k & 2,
		.docked = k & 4,
		.charging = k & 8,
		.rmssd_ms = (float)(k % 300),
		.n_diffs = (uint8_t)(k % 70),
		.cls = (uint8_t)(k % 4),
		.activity_mg = (float)((k * 7) % 300),
		.mlc_max = (uint8_t)(k % 9),
		.pulse_s = (uint8_t)(k % 33),
		.skin_cc = (int16_t)(2400 + (k % 300) * 10),
		.steps = (uint16_t)(k % 300),
		.pitch_deg = (int16_t)((k % 200) - 100),
		.roll_deg = (int16_t)((k % 400) - 200),
		.ox_r = k % 5 == 0 ? (float)(k % 250) / 100.0f : 0.0f,
		.ox_conf = (float)(k % 16) / 15.0f,
	};
	return r;
}

#endif /* ATRIUM_TEST_LOG_VEC_H_ */
```

## src/test_activity.c
```c
/*
 * Copyright (c) 2026 Het Bhavsar
 * SPDX-License-Identifier: Apache-2.0
 */
#include <limits.h>
#include <math.h>
#include <stdlib.h>
#include <zephyr/ztest.h>

#include "activity.h"

ZTEST_SUITE(activity, NULL, NULL, NULL, NULL, NULL);

ZTEST(activity, test_still_and_moving)
{
	struct activity a;
	struct activity_minute m;

	activity_init(&a);
	for (int min = 0; min < ACTIVITY_STILL_MIN; min++) {
		for (int i = 0; i < 60 * 15; i++) {
			activity_push(&a, 0, 0, 1000 + (i % 2 ? 5 : -5));
		}
		m = activity_close(&a);
		zassert_equal(m.index_mg, 5);
		zassert_false(m.moving);
	}
	zassert_true(m.still);

	for (int i = 0; i < 60 * 15; i++) {
		activity_push(&a, 300, 0, (i % 2) ? 1400 : 700);
	}
	m = activity_close(&a);
	zassert_true(m.moving, "index %u", m.index_mg);
	zassert_false(m.still);
}

ZTEST(activity, test_posture_angles)
{
	int16_t p, r;

	/* gravity along +z: level */
	posture_angles(0, 0, 1000 * 10, 10, &p, &r);
	zassert_equal(p, 0);
	zassert_equal(r, 0);
	/* along +y: rolled 90 degrees */
	posture_angles(0, 1000 * 10, 0, 10, &p, &r);
	zassert_equal(r, 90);
	/* along -x: pitched up 90 degrees */
	posture_angles(-1000 * 10, 0, 0, 10, &p, &r);
	zassert_equal(p, 90);
	/* upside down */
	posture_angles(0, 0, -1000, 1, &p, &r);
	zassert_true(r == 180 || r == -180);
	posture_angles(0, 0, 0, 0, &p, &r);
	zassert_equal(p, INT16_MIN);
}

ZTEST(activity, test_axes_rotation)
{
	/* the EVT placement (atrium_pod.dts): chip +Y = pod +x, chip +X = pod -y */
	static const int8_t evt[9] = {0, 1, 0, -1, 0, 0, 0, 0, 1};
	static const int8_t ident[9] = {1, 0, 0, 0, 1, 0, 0, 0, 1};
	static const int8_t mirror[9] = {-1, 0, 0, 0, 1, 0, 0, 0, 1}; /* det -1 */
	static const int8_t twice[9] = {1, 1, 0, 0, 0, 0, 0, 0, 1};
	int32_t pod[3];

	zassert_true(axes_valid(evt));
	zassert_true(axes_valid(ident));
	zassert_false(axes_valid(mirror), "a mirror is not a rotation");
	zassert_false(axes_valid(twice));
	/* worn upright, the antenna end is up: the chip reads +1 g on its Y */
	axes_to_pod(evt, (const int32_t[3]){0, 1000, 0}, pod);
	zassert_equal(pod[0], 1000);
	zassert_equal(pod[1], 0);
	axes_to_pod(evt, (const int32_t[3]){1000, 0, 0}, pod);
	zassert_equal(pod[1], -1000, "chip +X along pod -y");
}

/* Straight upright wear (2026-11-07: long axis vertical, no tilt toward the eye), pod
 * frame, right temporal region: the cases of atrium_ml position.POD_UP through the log's
 * 1-degree steps */
ZTEST(activity, test_vertical_wear_positions)
{
	int16_t p, r;

	/* upright: +x straight up, pitch -90, roll is noise */
	posture_angles(1000, 0, 0, 1, &p, &r);
	zassert_equal(p, -90);
	/* on the back: gravity on -y */
	posture_angles(0, -1000, 0, 1, &p, &r);
	zassert_equal(p, 0);
	zassert_equal(r, -90);
	/* face down: +y */
	posture_angles(0, 1000, 0, 1, &p, &r);
	zassert_equal(r, 90);
	/* on the pod's side, pod against the pillow: -z */
	posture_angles(0, 0, -1000, 1, &p, &r);
	zassert_equal(p, 0);
	zassert_true(r == 180 || r == -180);
	/* on the other side: +z */
	posture_angles(0, 0, 1000, 1, &p, &r);
	zassert_equal(r, 0);
}

/* ML's expected log angles (pitch, roll) on both sides of the head. On the left, +y points
 * forward, so the roll signs flip; the app knows the side */
static const struct {
	const char *pos;
	double right[3], left[3]; /* gravity, g, pod frame */
	int16_t pitch, roll_right, roll_left;
	bool roll_defined;
} wear[] = {
	{"upright", {1, 0, 0}, {1, 0, 0}, -90, 0, 0, false},
	{"back", {0, -1, 0}, {0, 1, 0}, 0, -90, 90, true},
	{"face down", {0, 1, 0}, {0, -1, 0}, 0, 90, -90, true},
	{"pod side", {0, 0, -1}, {0, 0, -1}, 0, 180, 180, true},
	{"other side", {0, 0, 1}, {0, 0, 1}, 0, 0, 0, true},
};

static int angle_diff(int a, int b)
{
	int d = (a - b) % 360;

	return d > 180 ? d - 360 : (d < -180 ? d + 360 : d);
}

static void check(const char *pos, const char *side, const double g[3], int16_t pitch,
		  int16_t roll, bool roll_defined, int tol)
{
	int16_t p, r;

	posture_angles(lround(g[0] * 1000), lround(g[1] * 1000), lround(g[2] * 1000), 1, &p, &r);
	zassert_within(p, pitch, tol, "%s %s pitch %d", pos, side, p);
	if (roll_defined) {
		zassert_true(abs(angle_diff(r, roll)) <= tol, "%s %s roll %d", pos, side, r);
	}
}

ZTEST(activity, test_vertical_wear_both_sides)
{
	for (size_t i = 0; i < ARRAY_SIZE(wear); i++) {
		check(wear[i].pos, "right", wear[i].right, wear[i].pitch, wear[i].roll_right,
		      wear[i].roll_defined, 0);
		check(wear[i].pos, "left", wear[i].left, wear[i].pitch, wear[i].roll_left,
		      wear[i].roll_defined, 0);
	}
}

/* People won't place it exactly: up to 15 degrees turned in the skin plane (about z) or rocked
 * (about y) moves each angle by no more than the error, so the app's +-15 degree classes hold */
ZTEST(activity, test_vertical_wear_placement_error)
{
	for (int deg = -15; deg <= 15; deg += 5) {
		double a = deg * 3.14159265358979 / 180.0, c = cos(a), sn = sin(a);

		for (size_t i = 0; i < ARRAY_SIZE(wear); i++) {
			for (int side = 0; side < 2; side++) {
				const double *g = side ? wear[i].left : wear[i].right;
				int16_t roll = side ? wear[i].roll_left : wear[i].roll_right;
				double gz[3] = {g[0] * c - g[1] * sn, g[0] * sn + g[1] * c, g[2]};
				double gy[3] = {g[0] * c + g[2] * sn, g[1], -g[0] * sn + g[2] * c};
				const char *s = side ? "left" : "right";

				check(wear[i].pos, s, gz, wear[i].pitch, roll, wear[i].roll_defined,
				      abs(deg) + 1);
				check(wear[i].pos, s, gy, wear[i].pitch, roll, wear[i].roll_defined,
				      abs(deg) + 1);
			}
		}
	}
}

ZTEST(activity, test_empty_minute)
{
	struct activity a;

	activity_init(&a);
	struct activity_minute m = activity_close(&a);

	zassert_equal(m.index_mg, 0);
	zassert_false(m.still);
}
```

## src/test_ble_policy.c
```c
/*
 * Copyright (c) 2026 Het Bhavsar
 * SPDX-License-Identifier: Apache-2.0
 *
 * ble_policy.h: which links the pod keeps, and the pairing window (docs/ble_gatt.md).
 */
#include <zephyr/ztest.h>

#include "ble_policy.h"

ZTEST_SUITE(ble_policy, NULL, NULL, NULL, NULL, NULL);

ZTEST(ble_policy, test_link_secure)
{
	zassert_true(ble_link_secure(2, true, 16), "LE Secure Connections, Just Works");
	zassert_true(ble_link_secure(4, true, 16), "LESC with a passkey");
	zassert_false(ble_link_secure(2, false, 16), "a legacy bond");
	zassert_false(ble_link_secure(3, false, 16), "legacy passkey");
	zassert_false(ble_link_secure(2, true, 7), "a short key");
	zassert_false(ble_link_secure(1, true, 16), "not encrypted");
}

/* One window for a new phone and for a phone pairing again over its lost bond */
ZTEST(ble_policy, test_pairing_window)
{
	zassert_true(ble_pairing_open(60000, 60000), "the last moment of the window");
	zassert_false(ble_pairing_open(60001, 60000), "after it");
	zassert_false(ble_pairing_open(0, -1), "no window yet");
}

/* 2 s on the Plinth and off the body (the docked-idle and off-body budgets count it at 2 s),
 * 1 s in every mode worn on the head */
ZTEST(ble_policy, test_adv_interval)
{
	for (int m = 0; m < MODE_COUNT; m++) {
		uint16_t want = (m == MODE_DOCKED_IDLE || m == MODE_OFFBODY) ? 2000 : 1000;

		zassert_equal(ble_adv_interval_ms(m), want, "%s", mode_get(m)->name);
	}
	zassert_equal(ble_adv_interval_ms(MODE_OFFBODY), 2000, "off-body, as budgeted");
	zassert_equal(ble_adv_interval_ms(MODE_SMART), 1000);
}
```

## src/test_bq21061.c
```c
/*
 * Copyright (c) 2026 Het Bhavsar
 * SPDX-License-Identifier: Apache-2.0
 *
 * BQ21061 settings against TI SLUSDU0A section 7.5 and the firmware review (2026-11-07).
 */
#include <zephyr/ztest.h>

#include "bq21061_regs.h"

ZTEST_SUITE(bq21061, NULL, NULL, NULL, NULL, NULL);

ZTEST(bq21061, test_ichg_codes)
{
	zassert_equal(bq21061_ichg_code(15000), 0x0C, "15 mA = 12 x 1.25 mA");
	zassert_equal(bq21061_ichg_code(5000), 0x04);
	zassert_equal(bq21061_ichg_code(6249), 0x04, "rounded down");
	zassert_equal(bq21061_ichg_code(0), 1, "0 is not a setting");
	zassert_equal(bq21061_ichg_code(1000000), 255);
}

ZTEST(bq21061, test_config_writes)
{
	struct bq21061_write w[4];

	zassert_equal(bq21061_config(15000, w, 3), 0, "too small a buffer");
	zassert_equal(bq21061_config(15000, w, ARRAY_SIZE(w)), 4);
	zassert_equal(w[0].reg, BQ21061_ICHG_CTRL);
	zassert_equal(w[0].val, 0x0C);
	/* cool band: TS_ICHRG 0b101 = 0.375 x 15 mA = 5.6 mA <= 0.2C of 30 mAh; warm band
	 * TS_VBAT_REG 0b011 = VBATREG - 150 mV, the reset value */
	zassert_equal(w[1].reg, BQ21061_TS_FASTCHGCTRL);
	zassert_equal(w[1].val & 0x07, 0x05);
	zassert_equal((w[1].val >> 4) & 0x07, 0x03);
	zassert_true(15000 * 375 / 1000 <= 30 * 200, "cool-band current within 0.2C");
	/* no charging above 45 C: TS_HOT 0x38 (262.5 mV), warm about 40 C above it in volts */
	zassert_equal(w[2].reg, BQ21061_TS_WARM);
	zassert_equal(w[3].reg, BQ21061_TS_HOT);
	zassert_equal(w[3].val, 0x38);
	zassert_true(w[2].val > w[3].val);
}

ZTEST(bq21061, test_charger_disable_keeps_other_bits)
{
	/* ICCTRL2 reset 0x40: PMID 4.5 V */
	zassert_equal(bq21061_icctrl2(0x40, true), 0x41);
	zassert_equal(bq21061_icctrl2(0x41, false), 0x40);
}

ZTEST(bq21061, test_status_decode)
{
	struct bq21061_status s;

	bq21061_decode(0x21, 0x04, &s);
	zassert_true(s.vin_good && s.done && s.ts_cool);
	zassert_false(s.cv || s.ts_cold || s.ts_hot || s.fault);
	bq21061_decode(0x41, 0x89, &s);
	zassert_true(s.cv && s.ts_hot && s.ts_cold && s.fault, "VIN over-voltage is a fault");
	bq21061_decode(0x01, 0x10, &s);
	zassert_false(s.fault, "battery under-voltage is pre-charge, not a fault");
}
```

## src/test_dfu_health.c
```c
/*
 * Copyright (c) 2026 Het Bhavsar
 * SPDX-License-Identifier: Apache-2.0
 */
#include <zephyr/ztest.h>

#include "dfu_health.h"

ZTEST_SUITE(dfu_health, NULL, NULL, NULL, NULL, NULL);

ZTEST(dfu_health, test_confirms_only_when_healthy_after_a_minute)
{
	zassert_equal(dfu_health_decide(false, 59, true), DFU_WAIT);
	zassert_equal(dfu_health_decide(false, 60, true), DFU_CONFIRM);
}

ZTEST(dfu_health, test_unhealthy_image_reverts)
{
	zassert_equal(dfu_health_decide(false, 299, false), DFU_WAIT);
	zassert_equal(dfu_health_decide(false, 300, false), DFU_REVERT);
}

ZTEST(dfu_health, test_confirmed_image_is_left_alone)
{
	zassert_equal(dfu_health_decide(true, 600, false), DFU_WAIT);
	zassert_equal(dfu_health_decide(true, 60, true), DFU_WAIT);
}
```

## src/test_epoch.c
```c
/*
 * Copyright (c) 2026 Het Bhavsar
 * SPDX-License-Identifier: Apache-2.0
 */
#include <zephyr/ztest.h>

#include "epoch.h"

ZTEST_SUITE(epoch, NULL, NULL, NULL, NULL, NULL);

static const struct epoch_close_in quiet = {
	.hrv = {.rmssd_x10 = 423, .n_diffs = 21},
	.mlc_max = 2,
	.cls = 1,
	.steps_pm = 104,
	.pitch_deg = -12,
	.roll_deg = 40,
	.activity_mg = 33,
	.skin_valid = true,
	.skin_cc = 3450,
};

ZTEST(epoch, test_worn_epoch)
{
	struct epoch e;
	struct log_record r;

	epoch_open(&e, 1000);
	for (int s = 0; s < 30; s++) {
		struct epoch_second es = {.on_skin = true, .pulse_present = s >= 4,
					  .bpm = s < 10 ? 0 : (s & 1 ? 61 : 63), .conf = 0.6f};

		epoch_second(&e, &es);
	}
	zassert_true(epoch_close(&e, &quiet, &r));
	zassert_within(r.bpm, 62.0f, 0.01f, "mean of the 20 reported seconds");
	zassert_within(r.conf, 0.6f, 0.001f);
	zassert_true(r.on_skin);
	zassert_false(r.docked || r.charging || r.pulse_ir);
	zassert_equal(r.pulse_s, 26);
	zassert_within(r.rmssd_ms, 42.3f, 0.01f);
	zassert_equal(r.n_diffs, 21);
	zassert_equal(r.steps, 52, "104 steps/min over 30 s, walking");
	zassert_equal(r.skin_cc, 3450);
	zassert_equal(r.ox_r, 0.0f);
}

ZTEST(epoch, test_still_epoch_has_no_steps_and_burst_lands)
{
	struct epoch e;
	struct log_record r;
	struct epoch_close_in in = quiet;

	in.cls = 0;
	in.ox = true;
	in.ox_r = 0.52f;
	in.ox_conf = 0.7f;
	in.skin_valid = false;
	epoch_open(&e, 0);
	for (int s = 0; s < 30; s++) {
		struct epoch_second es = {.on_skin = s < 10, .pulse_ir = true};

		epoch_second(&e, &es);
	}
	zassert_true(epoch_close(&e, &in, &r));
	zassert_equal(r.steps, 0);
	zassert_false(r.on_skin, "worn 10 of 30 s");
	zassert_true(r.pulse_ir);
	zassert_equal(r.ox_r, 0.52f);
	zassert_equal(r.skin_cc, LOG_SKIN_UNKNOWN);
}

ZTEST(epoch, test_docked_epoch_not_logged)
{
	struct epoch e;
	struct log_record r;

	epoch_open(&e, 0);
	for (int s = 0; s < 30; s++) {
		struct epoch_second es = {.docked = true, .charging = true};

		epoch_second(&e, &es);
	}
	zassert_false(epoch_close(&e, &quiet, &r), "wholly on the dock: a gap in the log");
	/* the epoch the pod was lifted in is logged, with the docked flag */
	epoch_open(&e, 30);
	for (int s = 0; s < 30; s++) {
		struct epoch_second es = {.docked = s < 5, .charging = s < 5};

		epoch_second(&e, &es);
	}
	zassert_true(epoch_close(&e, &quiet, &r));
	zassert_true(r.docked && r.charging);
}

ZTEST(epoch, test_next_start_time)
{
	zassert_equal(epoch_next_t0(0, false, 1234), 1234, "first epoch: the clock");
	zassert_equal(epoch_next_t0(1000, true, 1031), 1030, "runs on in 30 s steps");
	zassert_equal(epoch_next_t0(1000, true, 1028), 1030);
	zassert_equal(epoch_next_t0(1000, true, 1040), 1040, "a jump: the clock");
	/* the phone set the clock: uptime time base to Unix time */
	uint32_t up = LOG_TIME_UPTIME | 1000;

	zassert_equal(epoch_next_t0(up, true, up + 30), up + 30);
	zassert_equal(epoch_next_t0(up, true, 1800000000), 1800000000);
}
```

## src/test_gatt_encode.c
```c
/*
 * Copyright (c) 2026 Het Bhavsar
 * SPDX-License-Identifier: Apache-2.0
 *
 * Pins the byte layouts of docs/ble_gatt.md, which the app builds against.
 */
#include <math.h>
#include <zephyr/ztest.h>

#include "gatt_encode.h"
#include "log_record.h"

ZTEST_SUITE(gatt_encode, NULL, NULL, NULL, NULL, NULL);

ZTEST(gatt_encode, test_charge_state)
{
	struct app_status s = {
		.power = {.state = POD_DOCKED, .chg = CHG_COLD_LIMITED, .batt = BATT_LOW,
			  .band = CHG_BAND_COLD, .docked = true, .chg_disable = true,
			  .chg_cold = true, .mode = MODE_DOCKED_IDLE},
		.soc = 42, .vsys_mv = 4500,
		.skin_valid = true, .skin_cc = 3300, .top_valid = true, .top_cc = 790,
		.chg_stat0 = 0x01, .chg_stat1 = 0x04, .on_skin = false,
	};
	uint8_t b[GATT_CHARGE_STATE_LEN];

	zassert_equal(gatt_encode_charge_state(&s, b), 19);
	zassert_equal(b[0], 1);
	zassert_equal(b[1], 3);
	zassert_equal(b[2], 1);
	zassert_equal(b[3], 2);
	zassert_equal(b[4], 0x07);
	zassert_equal(b[5], 42);
	zassert_equal(b[6] | (b[7] << 8), 4500, "VSYS");
	zassert_equal(b[8] | (b[9] << 8), 0, "reserved: no VBUS sense");
	zassert_equal((int16_t)(b[10] | (b[11] << 8)), 790); /* TH4 top, primary */
	zassert_equal((int16_t)(b[12] | (b[13] << 8)), INT16_MIN, "reserved: no backup");
	zassert_equal(b[14], 0x01, "BQ21061 STAT0: VIN good");
	zassert_equal(b[15], 0x04, "BQ21061 STAT1: TS cool");
	zassert_equal(b[16], MODE_DOCKED_IDLE);
	zassert_equal((int16_t)(b[17] | (b[18] << 8)), INT16_MIN);

	s.on_skin = true;
	gatt_encode_charge_state(&s, b);
	zassert_equal(b[4], 0x0F);

	s.on_skin = false;
	s.on_case = true;
	gatt_encode_charge_state(&s, b);
	zassert_equal(b[4], 0x17, "bit 4: fed by the charging case");

	s.power.docked = false;
	gatt_encode_charge_state(&s, b);
	zassert_equal(b[14] | b[15], 0, "no charger status off the Plinth");
}

ZTEST(gatt_encode, test_skin_temp_and_activity)
{
	struct app_status s = {.skin_valid = true, .skin_cc = 3412, .top_cc = -40,
			       .activity_mg = 123, .moving = true, .mlc_max = 5, .mlc_class = 1,
			       .steps_pm = 104};
	uint8_t t[GATT_SKIN_TEMP_LEN], a[GATT_ACTIVITY_LEN];

	zassert_equal(gatt_encode_skin_temp(&s, 0x01020304, t), 9);
	zassert_equal(t[0] | (t[1] << 8), 3412);
	zassert_equal((int16_t)(t[2] | (t[3] << 8)), -40);
	zassert_equal(t[4], 0x01);
	zassert_equal(t[5], 0x04);
	zassert_equal(t[8], 0x01);

	zassert_equal(gatt_encode_activity(&s, 7, a), 10);
	zassert_equal(a[0], 7);
	zassert_equal(a[4] | (a[5] << 8), 123);
	zassert_equal(a[6], 0x01);
	zassert_equal(a[7], 5, "max MLC level");
	zassert_equal(a[8], 1, "class walk");
	zassert_equal(a[9], 104, "steps/min");
}

ZTEST(gatt_encode, test_oxygen_ratio)
{
	struct app_status s = {.ox_time = 0x01020304, .ox_r = 0.4508f, .ox_conf = 0.97f,
			       .ox_good = 12};
	uint8_t b[GATT_OXYGEN_LEN];

	zassert_equal(gatt_encode_oxygen(&s, b), 8);
	zassert_equal(b[0], 0x04);
	zassert_equal(b[3], 0x01);
	zassert_equal(b[4] | (b[5] << 8), 451, "R x 1000");
	zassert_equal(b[6], 247, "0.97 x 255");
	zassert_equal(b[7], 12);

	s.ox_r = NAN;
	s.ox_conf = 0.0f;
	s.ox_good = 2;
	gatt_encode_oxygen(&s, b);
	zassert_equal(b[4] | (b[5] << 8), 0, "no R");
	zassert_equal(b[6], 0);
}

ZTEST(gatt_encode, test_log_info_and_sleep_window)
{
	uint8_t b[GATT_LOG_INFO_LEN];
	struct app_settings s = APP_SETTINGS_DEFAULT;
	uint8_t w[GATT_SLEEP_WINDOW_LEN];

	/* 32 KB log: pages 12..19 held, 8 pages */
	zassert_equal(gatt_encode_log_info(12, 19, 8, b), 18);
	zassert_equal(b[0], 12);
	zassert_equal(b[4] | (b[5] << 8), 19);
	zassert_equal(b[8] | (b[9] << 8), 4096, "page size");
	zassert_equal(b[10], 30, "epoch, s");
	zassert_equal(b[12] | (b[13] << 8) | (b[14] << 16), 8);
	zassert_equal(b[16], 1, "format");
	zassert_equal(b[17], 12, "record size");

	gatt_encode_sleep_window(&s, w);
	zassert_equal(w[0] | (w[1] << 8), 23 * 60);
	zassert_equal(w[2] | (w[3] << 8), 7 * 60);

	const uint8_t ok[6] = {0x50, 0x05, 0x68, 0x01, 0x4A, 0x01}; /* 22:40, 06:00, +5:30 */
	const uint8_t bad[6] = {0xA0, 0x05, 0, 0, 0, 0};             /* 1440: out of range */

	zassert_ok(gatt_decode_sleep_window(ok, 6, &s));
	zassert_equal(s.sleep_start, 1360);
	zassert_equal(s.sleep_end, 360);
	zassert_equal(s.utc_offset_min, 330);
	zassert_equal(gatt_decode_sleep_window(bad, 6, &s), -1);
	zassert_equal(gatt_decode_sleep_window(ok, 5, &s), -1);
}

/* 7 Live Epoch 0x0504: time, head page, then the record exactly as the log holds it */
ZTEST(gatt_encode, test_live_epoch)
{
	struct log_record r = {.bpm = 63.4f, .conf = 0.8f, .on_skin = true, .rmssd_ms = 41.0f,
			       .n_diffs = 22, .activity_mg = 7.0f, .pulse_s = 30, .skin_cc = 3412,
			       .steps = 0, .pitch_deg = -88, .roll_deg = 10};
	uint8_t b[GATT_LIVE_EPOCH_LEN], rec[LOG_RECORD_SIZE];

	zassert_equal(gatt_encode_live_epoch(0x80000123U, 9, &r, b), 20, "one 23-byte MTU packet");
	zassert_equal(b[0] | b[1] << 8 | b[2] << 16 | (uint32_t)b[3] << 24, 0x80000123U,
		      "bit 31: uptime, as in the log");
	zassert_equal(b[4] | b[5] << 8 | b[6] << 16 | (uint32_t)b[7] << 24, 9, "head page");
	log_record_pack(&r, rec);
	zassert_mem_equal(&b[8], rec, LOG_RECORD_SIZE, "the logged bytes");
	zassert_equal(b[8], 63);
	zassert_true(log_record_written(&b[8]));
}

ZTEST(gatt_encode, test_motion_rate_field)
{
	/* mHz as before up to 32.767 Hz; above it bit 15 and 10 mHz steps */
	zassert_equal(gatt_motion_rate(12500), 12500);
	zassert_equal(gatt_motion_rate(0), 0);
	zassert_equal(gatt_motion_rate(32767), 32767);
	zassert_equal(gatt_motion_rate(104000), 0xA8A0, "104 Hz in the research modes");
	zassert_equal(gatt_motion_rate(104000) & 0x7FFF, 10400);
	zassert_equal(gatt_motion_rate(10000000), 0xFFFF, "saturates");
}
```

## src/test_hrv.c
```c
/*
 * Copyright (c) 2026 Het Bhavsar
 * SPDX-License-Identifier: Apache-2.0
 *
 * Basic behaviour of the max-slope HRV port; agreement with the reference is checked in
 * test_ml_vectors.c.
 */
#include <math.h>
#include <zephyr/ztest.h>

#include "hrv.h"

static struct hrv h;

/* intensity counts of a pulse train with the given intervals */
static void feed(const float *rr_ms, int n_rr, int repeats)
{
	float beats[400];
	int nb = 0;
	float t = 1500.0f;

	for (int r = 0; r < repeats; r++) {
		for (int i = 0; i < n_rr && nb < 400; i++) {
			beats[nb++] = t;
			t += rr_ms[i];
		}
	}
	int samples = (int)(t / 1000.0f * HRV_FS);

	for (int k = 0; k < samples; k++) {
		float tk = k * 1000.0f / HRV_FS, v = 0;

		for (int b = 0; b < nb; b++) {
			float d = (tk - beats[b]) / 90.0f;

			if (d > -4 && d < 4) {
				v += expf(-0.5f * d * d);
			}
		}
		hrv_push(&h, (int32_t)(150000.0f - 900.0f * v));
	}
}

static struct hrv_window close_all(void)
{
	hrv_flush(&h);
	return hrv_close(&h, hrv_time_s(&h) - 0.5);
}

ZTEST_SUITE(hrv, NULL, NULL, NULL, NULL, NULL);

ZTEST(hrv, test_alternating_rr_gives_known_rmssd)
{
	/* 800 / 850 ms alternating: every successive difference is 50 ms */
	static const float rr[] = {800, 850};

	hrv_init(&h, 25);
	feed(rr, 2, 20);
	struct hrv_window w = close_all();

	zassert_true(w.n_diffs >= 30, "%u diffs", w.n_diffs);
	zassert_within(w.rmssd_x10, 500, 50, "rmssd %u", w.rmssd_x10);
}

ZTEST(hrv, test_steady_rhythm_is_near_zero)
{
	static const float rr[] = {1000};

	hrv_init(&h, 25);
	feed(rr, 1, 30);
	struct hrv_window w = close_all();

	zassert_true(w.n_diffs >= 20);
	zassert_true(w.rmssd_x10 < 50, "rmssd %u", w.rmssd_x10);
}

ZTEST(hrv, test_missed_beat_is_rejected)
{
	static const float rr[] = {800, 850, 800, 850, 800, 850, 1650, 800, 850, 800, 850, 800};

	hrv_init(&h, 25);
	feed(rr, ARRAY_SIZE(rr), 3);
	struct hrv_window w = close_all();

	zassert_within(w.rmssd_x10, 500, 60, "rmssd %u", w.rmssd_x10);
}

ZTEST(hrv, test_too_few_beats_reports_zero)
{
	static const float rr[] = {900};

	hrv_init(&h, 25);
	feed(rr, 1, 5);
	struct hrv_window w = close_all();

	zassert_equal(w.rmssd_x10, 0);
	zassert_true(w.n_diffs < HRV_MIN_DIFFS);
}

ZTEST(hrv, test_only_at_25_hz)
{
	static const float rr[] = {900};

	hrv_init(&h, 32);
	feed(rr, 1, 20);
	zassert_equal(close_all().beats, 0);
}
```

## src/test_log_record.c
```c
/*
 * Copyright (c) 2026 Het Bhavsar
 * SPDX-License-Identifier: Apache-2.0
 *
 * The 12-byte record against app/python/atrium_ml/logrec.py encode(), byte for byte.
 */
#include <stdlib.h>
#include <zephyr/ztest.h>

#include "log_record.h"
#include "log_vec.h"

ZTEST_SUITE(log_record, NULL, NULL, NULL, NULL, NULL);

static void hex(const char *s, uint8_t out[LOG_RECORD_SIZE])
{
	for (int i = 0; i < LOG_RECORD_SIZE; i++) {
		char b[3] = {s[2 * i], s[2 * i + 1], 0};

		out[i] = (uint8_t)strtoul(b, NULL, 16);
	}
}

/* python3 -c "from atrium_ml import logrec" ... encode(ep(k)).hex(), the generator of log_vec.h */
ZTEST(log_record, test_matches_logrec_encode)
{
	static const struct {
		int k;
		const char *hex;
	} v[] = {
		{0, "0000000000000000a6a60000"},    {1, "3311014107090001a6a60000"},
		{7, "007707c7313f0007a6a60000"},    {123, "35bb7bf5ffc6717b17da0000"},
		{255, "41fffeedffc3f5ffd31c050f"},  {299, "6dbbfed3ff12feffff320000"},
		{1000, "5a88641464515a64a6000000"},
	};

	for (size_t i = 0; i < ARRAY_SIZE(v); i++) {
		struct log_record r = vec_epoch(v[i].k);
		uint8_t want[LOG_RECORD_SIZE], got[LOG_RECORD_SIZE];

		hex(v[i].hex, want);
		log_record_pack(&r, got);
		zassert_mem_equal(got, want, LOG_RECORD_SIZE, "epoch %d", v[i].k);
		zassert_true(log_record_written(got));
	}
}

ZTEST(log_record, test_round_trip)
{
	struct log_record r = {.bpm = 61.4f, .conf = 0.8f, .on_skin = true, .pulse_ir = true,
			       .rmssd_ms = 42.3f, .n_diffs = 21, .cls = 1, .activity_mg = 37.0f,
			       .mlc_max = 3, .pulse_s = 28, .skin_cc = 3462, .steps = 54,
			       .pitch_deg = -12, .roll_deg = 91, .ox_r = 0.45f, .ox_conf = 0.6f};
	struct log_record o;
	uint8_t b[LOG_RECORD_SIZE];

	log_record_pack(&r, b);
	log_record_unpack(b, &o);
	zassert_equal(o.bpm, 61.0f);
	zassert_within(o.conf, 0.8f, 0.04f);
	zassert_true(o.on_skin && o.pulse_ir && !o.docked && !o.charging);
	zassert_equal(o.rmssd_ms, 42.0f);
	zassert_equal(o.n_diffs, 21);
	zassert_equal(o.cls, 1);
	zassert_equal(o.mlc_max, 3);
	zassert_equal(o.pulse_s, 28);
	zassert_equal(o.skin_cc, 3460, "0.1 C steps");
	zassert_equal(o.steps, 54);
	zassert_equal(o.pitch_deg, -12);
	zassert_equal(o.roll_deg, 92, "2 degree steps, half to even");
	zassert_within(o.ox_r, 0.45f, 0.001f);
	zassert_within(o.ox_conf, 0.6f, 0.04f);
}

ZTEST(log_record, test_unknown_and_limits)
{
	struct log_record r = {.rmssd_ms = 0.3f, .skin_cc = LOG_SKIN_UNKNOWN,
			       .pitch_deg = LOG_ANGLE_UNKNOWN, .roll_deg = LOG_ANGLE_UNKNOWN,
			       .steps = 900, .pulse_s = 31, .n_diffs = 99, .activity_mg = 999.0f,
			       .ox_r = 0.0f, .ox_conf = 1.0f};
	uint8_t b[LOG_RECORD_SIZE];

	log_record_pack(&r, b);
	zassert_equal(b[2], 1, "RMSSD under 0.5 ms is still a value");
	zassert_equal(b[3], 63);
	zassert_equal(b[4], 255);
	zassert_equal(b[5] >> 3, 30);
	zassert_equal(b[6], 0);
	zassert_equal(b[7], 255);
	zassert_equal((int8_t)b[8], -128);
	zassert_equal((int8_t)b[9], -128);
	zassert_equal(b[10], 0);
	zassert_equal(b[11], 0, "no burst, no confidence");

	r.skin_cc = 2504; /* 25.04 C: below the range */
	log_record_pack(&r, b);
	zassert_equal(b[6], 0);
	r.skin_cc = 5200;
	log_record_pack(&r, b);
	zassert_equal(b[6], 254);

	static const uint8_t erased[LOG_RECORD_SIZE] = {
		0xFF, 0xFF, 0xFF, 0xFF, 0xFF, 0xFF, 0xFF, 0xFF, 0xFF, 0xFF, 0xFF, 0xFF};

	zassert_false(log_record_written(erased));
}
```

## src/test_logpack.c
```c
/*
 * Copyright (c) 2026 Het Bhavsar
 * SPDX-License-Identifier: Apache-2.0
 *
 * The page writer on a RAM flash that allows each byte to be written once after an erase,
 * as the nRF52 does. The pages must equal logrec.pack_pages() for the same runs, and a
 * reset at any write must leave a log that logrec.decode_blocks() reads.
 */
#include <string.h>
#include <zephyr/sys/byteorder.h>
#include <zephyr/sys/crc.h>
#include <zephyr/ztest.h>

#include "log_vec.h"
#include "logpack.h"

#define PAGES 8

static uint8_t mem[PAGES * LOG_PAGE_SIZE];
static int writes_left; /* < 0: no reset */
static int cut_bytes;   /* the failing write gets this many bytes (whole words) in first */
static bool overwrite;
static struct logpack_state saved;
static int persists;
static struct logpack lp;

static int f_read(void *ctx, uint32_t off, void *buf, size_t len)
{
	ARG_UNUSED(ctx);
	memcpy(buf, &mem[off], len);
	return 0;
}

static int f_write(void *ctx, uint32_t off, const void *buf, size_t len)
{
	const uint8_t *b = buf;

	ARG_UNUSED(ctx);
	if (writes_left == 0) {
		return -EIO;
	}
	size_t n = len;

	if (writes_left > 0 && --writes_left == 0) {
		n = MIN((size_t)cut_bytes, len); /* the reset lands inside this write */
	}
	for (size_t i = 0; i < n; i++) {
		overwrite |= mem[off + i] != 0xFF;
		mem[off + i] = b[i];
	}
	return n == len ? 0 : -EIO;
}

static int f_erase(void *ctx, uint32_t off, size_t len)
{
	ARG_UNUSED(ctx);
	if (writes_left == 0) {
		return -EIO;
	}
	memset(&mem[off], 0xFF, len);
	return 0;
}

static void f_persist(void *ctx, const struct logpack_state *st)
{
	ARG_UNUSED(ctx);
	saved = *st;
	persists++;
}

static const struct logpack_flash fl = {f_read, f_write, f_erase, f_persist, NULL};

static void before(void *f)
{
	ARG_UNUSED(f);
	memset(mem, 0x5A, sizeof(mem)); /* not erased: mount without state must erase */
	writes_left = -1;
	overwrite = false;
	persists = 0;
	zassert_ok(logpack_mount(&lp, &fl, PAGES, NULL));
}

ZTEST_SUITE(logpack, NULL, NULL, before, NULL, NULL);

static void append(uint32_t t, int k)
{
	struct log_record r = vec_epoch(k);
	uint8_t b[LOG_RECORD_SIZE];

	log_record_pack(&r, b);
	zassert_ok(logpack_append(&lp, t, b), "epoch %d", k);
}

/* logrec.decode_blocks in C: count records and check every block of one page */
struct seen {
	int n;
	uint32_t last_t;
	int open_blocks;
};

static void decode_page(const uint8_t *pg, struct seen *s)
{
	uint32_t i = 0;

	while (i + LOG_HEADER_SIZE + LOG_RECORD_SIZE <= LOG_PAGE_SIZE) {
		uint32_t t0 = sys_get_le32(&pg[i]), w1 = sys_get_le32(&pg[i + 4]);
		int n = 0;

		if (t0 == 0xFFFFFFFF) {
			break;
		}
		if (w1 == 0xFFFFFFFF) {
			while (i + LOG_HEADER_SIZE + (n + 1) * LOG_RECORD_SIZE <= LOG_PAGE_SIZE &&
			       log_record_written(&pg[i + LOG_HEADER_SIZE + n * LOG_RECORD_SIZE])) {
				n++;
			}
			s->open_blocks++;
		} else {
			n = pg[i + 7];
			zassert_equal(pg[i + 6], LOG_FORMAT);
			zassert_true(n > 0 && i + LOG_HEADER_SIZE + n * LOG_RECORD_SIZE <= LOG_PAGE_SIZE,
				     "bad block at %u", i);
		}
		for (int k = 0; k < n; k++) {
			zassert_true(log_record_written(&pg[i + LOG_HEADER_SIZE + k * LOG_RECORD_SIZE]),
				     "reserved bits set in block at %u", i);
		}
		s->n += n;
		s->last_t = t0 + LOG_EPOCH_S * (n - 1);
		i += LOG_HEADER_SIZE + n * LOG_RECORD_SIZE;
		if (w1 == 0xFFFFFFFF) {
			break;
		}
	}
}

static struct seen decode_all(void)
{
	struct seen s = {0};

	for (uint32_t p = lp.st.oldest; p <= lp.st.head; p++) {
		decode_page(&mem[(p % PAGES) * LOG_PAGE_SIZE], &s);
	}
	return s;
}

/* The same three runs as the generator: logrec.pack_pages gives 3 pages, crc32 0x91fffa11 */
ZTEST(logpack, test_pages_match_logrec_pack_pages)
{
	for (int k = 0; k < 300; k++) {
		append(1000 + 30 * k, k);
	}
	for (int k = 300; k < 700; k++) {
		append(1000 + 30 * 300 + 600 + 30 * (k - 300), k);
	}
	for (int k = 700; k < 760; k++) {
		append((1UL << 31 | 5) + 30 * (k - 700), k);
	}
	zassert_ok(logpack_close(&lp));
	zassert_equal(lp.st.head, 2);
	zassert_equal(crc32_ieee(mem, 3 * LOG_PAGE_SIZE), 0x91fffa11);
	zassert_false(overwrite, "a byte was written twice");
	struct seen s = decode_all();

	zassert_equal(s.n, 760);
}

ZTEST(logpack, test_gap_free_page_holds_340)
{
	for (int k = 0; k < 340; k++) {
		append(30 * k, k);
	}
	zassert_equal(lp.st.head, 0);
	append(30 * 340, 340);
	zassert_equal(lp.st.head, 1, "record 341 opens the next page");
}

ZTEST(logpack, test_ring_drops_oldest_page)
{
	for (int k = 0; k < 340 * 9 + 1; k++) {
		append(30 * k, k);
	}
	zassert_equal(lp.st.head, 9);
	zassert_equal(lp.st.oldest, 2, "8 pages held");
	zassert_equal(saved.head, 9, "persisted at each page");
	uint8_t b[4];

	zassert_equal(logpack_read_page(&lp, 1, 0, b, 4), -ERANGE);
	zassert_ok(logpack_read_page(&lp, 2, 0, b, 4));
	zassert_equal(sys_get_le32(b), 30 * 340 * 2, "page 2 starts with epoch 680");
	zassert_equal(logpack_read_page(&lp, 10, 0, b, 4), -ERANGE);
	zassert_false(overwrite);
}

ZTEST(logpack, test_reboot_closes_open_block_and_resumes)
{
	for (int k = 0; k < 10; k++) {
		append(30 * k, k);
	}
	/* reset: the block is open (second header word erased) */
	zassert_equal(sys_get_le32(&mem[4]), 0xFFFFFFFF);
	zassert_ok(logpack_mount(&lp, &fl, PAGES, &saved));
	zassert_equal(mem[7], 10, "closed with 10 records on boot");
	zassert_equal(mem[4] | (mem[5] << 8), 0, "block sequence 0");
	append(30 * 50, 50);
	zassert_ok(logpack_close(&lp));
	zassert_equal(mem[8 + 120 + 4], 1, "the next block is sequence 1");
	zassert_false(overwrite);
	zassert_equal(decode_all().n, 11);
}

/* A reset at every write of a long run, each followed by a reboot and more epochs: the log
 * always decodes, never writes a byte twice, and loses at most the record being written. */
ZTEST(logpack, test_reset_at_any_write)
{
	for (int cut = 1; cut < 600; cut += 7) {
		/* the NVMC writes whole words: a reset leaves 0, 1 or 2 words of a record */
		for (int bytes = 0; bytes < 12; bytes += 4) {
			before(NULL);
			writes_left = cut;
			cut_bytes = bytes;
			int ok = 0;

			for (int k = 0; k < 400; k++) {
				struct log_record r = vec_epoch(k);
				uint8_t b[LOG_RECORD_SIZE];

				log_record_pack(&r, b);
				if (logpack_append(&lp, 30 * k, b)) {
					break;
				}
				ok++;
			}
			writes_left = -1;
			zassert_ok(logpack_mount(&lp, &fl, PAGES, &saved));
			for (int k = 0; k < 50; k++) {
				append(100000 + 30 * k, k);
			}
			zassert_ok(logpack_close(&lp));
			struct seen s = decode_all();

			zassert_false(overwrite, "cut %d/%d: a byte written twice", cut, bytes);
			zassert_equal(s.open_blocks, 0, "cut %d/%d: open block, head %u off %u", cut, bytes, lp.st.head, lp.off);
			zassert_true(s.n >= ok - 1 + 50 && s.n <= ok + 1 + 50, "cut %d/%d: %d of %d",
				     cut, bytes, s.n, ok + 50);
		}
	}
}

ZTEST(logpack, test_erase_all_keeps_counting)
{
	for (int k = 0; k < 400; k++) {
		append(30 * k, k);
	}
	zassert_ok(logpack_erase_all(&lp));
	zassert_equal(lp.st.head, 2);
	zassert_equal(lp.st.oldest, 2);
	zassert_equal(saved.head, 2);
	append(5000, 1);
	zassert_ok(logpack_close(&lp));
	zassert_equal(decode_all().n, 1);
}
```

## src/test_maxm86161.c
```c
/*
 * Copyright (c) 2026 Het Bhavsar
 * SPDX-License-Identifier: Apache-2.0
 *
 * Register encoding checked against the MAXM86161 data sheet (19-100523 Rev 1).
 */
#include <zephyr/ztest.h>

#include "maxm86161_regs.h"

ZTEST_SUITE(maxm86161, NULL, NULL, NULL, NULL, NULL);

ZTEST(maxm86161, test_led_codes_match_the_pa_table)
{
	uint8_t rge, code;

	/* 31 mA range: 0xFF = 31.0 mA, LSB 0.12 mA */
	zassert_ok(maxm86161_led_code(31000, &rge, &code));
	zassert_equal(rge, 0);
	zassert_equal(code, 0xFF);
	zassert_ok(maxm86161_led_code(15000, &rge, &code));
	zassert_equal(rge, 0);
	zassert_within(maxm86161_led_ua(rge, code), 15000, 61);
	/* the data sheet example: range 3 code 0x20 = 15.36 mA (table: 0.48 mA LSB) */
	zassert_within(maxm86161_led_ua(3, 0x20), 15560, 200);
	/* 40 mA needs the 62 mA range */
	zassert_ok(maxm86161_led_code(40000, &rge, &code));
	zassert_equal(rge, 1);
	zassert_equal(maxm86161_led_code(65000, &rge, &code), 0);
	zassert_equal(rge, 2);
	zassert_equal(maxm86161_led_code(125000, &rge, &code), -1);
}

ZTEST(maxm86161, test_sample_rate_codes)
{
	zassert_equal(maxm86161_sr_code(25), 0x00);
	zassert_equal(maxm86161_sr_code(50), 0x01);
	zassert_equal(maxm86161_sr_code(8), 0x0A);
	zassert_equal(maxm86161_sr_code(32), 0x0C);
	zassert_equal(maxm86161_sr_code(64), 0x0D);
	zassert_equal(maxm86161_sr_code(4), -1, "4 Hz is not a PPG_SR rate");
}

ZTEST(maxm86161, test_encode_sequence)
{
	struct maxm86161_slot s[3] = {{MAXM86161_LEDC_GREEN, 15000},
				      {MAXM86161_LEDC_IR, 10000},
				      {MAXM86161_LEDC_RED, 40000}};
	struct maxm86161_cfg_regs r;

	zassert_ok(maxm86161_encode(s, 3, 50, &r));
	zassert_equal(r.seq[0], 0x21); /* LEDC2 = IR (2), LEDC1 = green (1) */
	zassert_equal(r.seq[1], 0x03); /* LEDC4 = none, LEDC3 = red */
	zassert_equal(r.seq[2], 0x00);
	zassert_equal(r.range1, 0x10); /* LED3 (red) on the 62 mA range */
	zassert_equal(r.pa[0], 123);   /* 15 mA x 255 / 31 mA */
	zassert_equal(r.ppg_cfg2, 0x01 << 3);

	struct maxm86161_slot dup[2] = {{MAXM86161_LEDC_GREEN, 5000}, {MAXM86161_LEDC_GREEN, 9000}};

	zassert_equal(maxm86161_encode(dup, 2, 25, &r), -1, "one PA register per LED");
	zassert_equal(maxm86161_encode(s, 3, 30, &r), -1, "30 Hz is not a rate");
}

ZTEST(maxm86161, test_encode_direct_ambient)
{
	/* research modes: green, IR, red, then direct ambient (LEDC 0x9, data sheet Table 2) */
	struct maxm86161_slot s[4] = {{MAXM86161_LEDC_GREEN, 15000},
				      {MAXM86161_LEDC_IR, 10000},
				      {MAXM86161_LEDC_RED, 10000},
				      {MAXM86161_LEDC_DA, 0}};
	struct maxm86161_cfg_regs r;

	for (uint16_t hz = 100; hz <= 200; hz += 100) {
		zassert_ok(maxm86161_encode(s, 4, hz, &r), "%u Hz", hz);
		zassert_equal(r.seq[0], 0x21); /* LEDC2 = IR, LEDC1 = green */
		zassert_equal(r.seq[1], 0x93); /* LEDC4 = direct ambient, LEDC3 = red */
		zassert_equal(r.seq[2], 0x00);
		zassert_equal(r.range1, 0x00, "all three LEDs on the 31 mA range");
		zassert_equal(r.pa[0], 123);
		zassert_equal(r.pa[1], 82); /* 10 mA x 255 / 31 mA */
		zassert_equal(r.pa[2], 82);
	}
	zassert_equal(r.ppg_cfg2, 0x04 << 3, "PPG_SR 200 Hz");
	/* its FIFO tag is its slot: 0x04 */
	uint8_t w[3] = {0x04 << 3, 0x12, 0x34};
	uint8_t tag;
	uint32_t v;

	maxm86161_fifo_decode(w, &tag, &v);
	zassert_equal(tag, 0x04);
	zassert_equal(maxm86161_tag_slot(tag), 3);
	zassert_equal(v, 0x1234);

	struct maxm86161_slot two_da[2] = {{MAXM86161_LEDC_DA, 0}, {MAXM86161_LEDC_DA, 0}};

	zassert_equal(maxm86161_encode(two_da, 2, 100, &r), -1, "one ambient slot");
	struct maxm86161_slot bad[1] = {{0x8, 1000}}; /* pilot: not used */

	zassert_equal(maxm86161_encode(bad, 1, 100, &r), -1);
}

ZTEST(maxm86161, test_encode_sample_averaging)
{
	/* averaged research modes: PPG_SR 200 Hz (0x04), SMP_AVE 4 (0b010) or 8 (0b011) */
	struct maxm86161_slot s[4] = {{MAXM86161_LEDC_GREEN, 15000},
				      {MAXM86161_LEDC_IR, 10000},
				      {MAXM86161_LEDC_RED, 10000},
				      {MAXM86161_LEDC_DA, 0}};
	struct maxm86161_cfg_regs r;

	zassert_ok(maxm86161_encode_avg(s, 4, 200, 4, &r));
	zassert_equal(r.ppg_cfg2, (0x04 << 3) | 0x2);
	zassert_equal(r.seq[1], 0x93, "the slots are unchanged");
	zassert_ok(maxm86161_encode_avg(s, 4, 200, 8, &r));
	zassert_equal(r.ppg_cfg2, (0x04 << 3) | 0x3);
	zassert_ok(maxm86161_encode_avg(s, 4, 200, 1, &r));
	zassert_equal(r.ppg_cfg2, 0x04 << 3, "1 = no averaging");
	zassert_ok(maxm86161_encode_avg(s, 1, 25, 128, &r));
	zassert_equal(r.ppg_cfg2 & 0x7, 0x7);
	zassert_equal(maxm86161_encode_avg(s, 4, 200, 3, &r), -1, "not a power of 2");
	zassert_equal(maxm86161_encode_avg(s, 4, 200, 0, &r), -1);
	/* encode() is encode_avg() with 1 */
	zassert_ok(maxm86161_encode(s, 4, 200, &r));
	zassert_equal(r.ppg_cfg2, 0x04 << 3);
}

ZTEST(maxm86161, test_fifo_decode_and_tags)
{
	uint8_t tag;
	uint32_t v;
	const uint8_t a[3] = {0x0F, 0xFF, 0xFF}; /* tag 1, 0x7FFFF */
	const uint8_t b[3] = {0x10, 0x00, 0x2A}; /* tag 2, 42 */
	const uint8_t inv[3] = {0xF0, 0x00, 0x00};

	maxm86161_fifo_decode(a, &tag, &v);
	zassert_equal(tag, 1);
	zassert_equal(v, 0x7FFFF);
	zassert_equal(maxm86161_tag_slot(tag), 0);
	maxm86161_fifo_decode(b, &tag, &v);
	zassert_equal(tag, 2);
	zassert_equal(v, 42);
	zassert_equal(maxm86161_tag_slot(tag), 1);
	maxm86161_fifo_decode(inv, &tag, &v);
	zassert_equal(tag, MAXM86161_TAG_INVALID);
	zassert_equal(maxm86161_tag_slot(tag), -1);
	zassert_equal(maxm86161_tag_slot(0x0E), 1, "picket-fence replacement of LEDC2");
	zassert_equal(maxm86161_tag_slot(0x19), -1, "proximity data is not a slot");
}
```
