## firmware/boards/atrium/atrium_pod/Kconfig.defconfig
```kconfig
# Copyright (c) 2026 Het Bhavsar
# SPDX-License-Identifier: Apache-2.0

if BOARD_ATRIUM_POD

config HW_STACK_PROTECTION
	default ARCH_HAS_STACK_PROTECTION

endif # BOARD_ATRIUM_POD
```

## firmware/boards/atrium/atrium_pod/board.yml
```yaml
board:
  name: atrium_pod
  full_name: Atrium pod EVT
  vendor: atrium
  socs:
    - name: nrf52832
```

## firmware/boards/localforge/atrium_pod/Kconfig.atrium_pod
```kconfig
# Copyright (c) 2026 Local Forge
# SPDX-License-Identifier: Apache-2.0

config BOARD_ATRIUM_POD
	select SOC_NRF52832_CIAA
```

## firmware/boards/localforge/atrium_pod/board.yml
```yaml
board:
  name: atrium_pod
  full_name: Atrium pod Rev B.2
  vendor: localforge
  socs:
    - name: nrf52832
```

## firmware/drivers/Kconfig
```kconfig
# Copyright (c) 2026 Het Bhavsar
# SPDX-License-Identifier: Apache-2.0

menuconfig MAXM86161
	bool "MAXM86161 optical module"
	default y
	depends on DT_HAS_ADI_MAXM86161_ENABLED
	select I2C
	select GPIO
	help
	  Driver for the MAXM86161A optical module (pod U3). The MAXM86161
	  has the same register map and part ID, so it runs either part.

if MAXM86161

config MAXM86161_INIT_PRIORITY
	int "Init priority"
	default 80

module = MAXM86161
module-str = maxm86161
source "subsys/logging/Kconfig.template.log_config"

endif # MAXM86161
```

## firmware/drivers/dts/bindings/power/ti,bq21061.yaml
```yaml
# Copyright (c) 2026 Het Bhavsar
# SPDX-License-Identifier: Apache-2.0

description: |
  BQ21061 linear charger with power path (PMID = VSYS), I2C address 0x6B.
  /LP is tied low on the pod, so the charger's I2C works only while VIN is
  present (pod on the Plinth). The TS pin reads the cell NTC (TH5).

compatible: "ti,bq21061"

include: i2c-device.yaml

properties:
  pg-gpios:
    type: phandle-array
    required: true
    description: /PG, open drain, low while a valid input is present.
  constant-charge-current-max-microamp:
    type: int
    required: true
    description: Fast-charge current, 1.25 mA steps.
  cold-charge-current-microamp:
    type: int
    required: true
    description: |
      Fast-charge current the firmware sets while its own temperature reading
      is in the cold band (0 to 10 C), at most 0.2C.
```

## firmware/drivers/dts/bindings/sensor/adi,maxm86161.yaml
```yaml
# Copyright (c) 2026 Local Forge
# SPDX-License-Identifier: Apache-2.0

description: |
  MAXM86161 optical module (AFE, green, IR and red LEDs, one photodiode),
  I2C address 0x62.

compatible: "adi,maxm86161"

include: i2c-device.yaml

properties:
  int-gpios:
    type: phandle-array
    required: true
    description: INTB, open drain, active low. Needs a pull-up.
  ldo-en-gpios:
    type: phandle-array
    required: true
    description: LDO_EN. High powers the module; low is 0.05 uA. 1 MOhm pull-down on the board.
```

## firmware/drivers/dts/bindings/sensor/maxim,maxm86161.yaml
```yaml
# Copyright (c) 2026 Local Forge
# SPDX-License-Identifier: Apache-2.0

description: |
  MAXM86161 optical module (AFE, green, IR and red LEDs, one photodiode),
  I2C address 0x62.

compatible: "maxim,maxm86161"

include: i2c-device.yaml

properties:
  int-gpios:
    type: phandle-array
    required: true
    description: INTB, open drain, active low. Needs a pull-up.
  en-gpios:
    type: phandle-array
    required: true
    description: LDO_EN. High powers the module; low is 0.05 uA.
  sync-gpios:
    type: phandle-array
    description: GPIO pin, open drain. Optional frame sync; not used by the driver yet.
```

## firmware/src/Kconfig
```kconfig
# Copyright (c) 2026 Local Forge
# SPDX-License-Identifier: Apache-2.0

mainmenu "Atrium pod firmware"

rsource "../drivers/Kconfig"

menu "Atrium"

config ATRIUM_TICK_MS
	int "Power state machine period (ms)"
	default 1000
	help
	  The charge policy assumes at most this gap between updates (charge_policy_cfg.update_ms).

config ATRIUM_DFU_MIN_MV
	int "Lowest VSYS for a firmware update off the dock (mV)"
	default 3600

module = ATRIUM
module-str = atrium
source "subsys/logging/Kconfig.template.log_config"

endmenu

source "Kconfig.zephyr"
```

## firmware/src/sample.yaml
```yaml
sample:
  name: Atrium pod firmware
tests:
  atrium.pod.build:
    sysbuild: true
    build_only: true
    extra_args:
      - BOARD_ROOT=..
    platform_allow:
      - atrium_pod
    integration_platforms:
      - atrium_pod
    tags: atrium
```
